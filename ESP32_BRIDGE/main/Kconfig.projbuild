## ESP32_BRIDGE/main/Kconfig.projbuild
```kconfig
menu "K57 мост: сеть"

config K57_AP_ONLY
    bool "Роутер из sdkconfig.local не брать"
    default n
    help
        С 13.11.2026 своя точка K57 есть всегда, а роутер - вдобавок, и
        задаётся он со страницы моста (вкладка «Мост», хранится в NVS;
        net_wifi.c). Эта настройка значит теперь только одно: пока со страницы
        роутер не задан, не брать K57_WIFI_SSID / K57_WIFI_PASS отсюда.

        До 13.11.2026 - «только своя точка». Тогда было «или - или», и на
        стенде 10.11.2026 через домашний роутер при сигнале -65..-70 дБм эфир
        не тянул ленту, терялась каждая десятая датаграмма, а напрямую - ни
        одной. Для живой ленты это верно и сейчас: нужен сигнал покрепче.

        Задаётся в sdkconfig.local: CONFIG_K57_AP_ONLY=y.

config K57_WIFI_SSID
    string "SSID сети WiFi"
    default ""
    help
        Сеть, к которой подключается мост.

        Значение задаётся в ESP32_BRIDGE/sdkconfig.local - файле, которого нет
        в репозитории: у каждой машины своя сеть, и имя сети с паролем в общей
        истории коммитов - лишние сведения наружу.

        Только начальное значение: со страницы роутер задаётся заново и
        хранится в NVS моста. Пустое имя - роутера нет, только своя точка.

config K57_WIFI_PASS
    string "Пароль WiFi"
    default ""
    help
        Там же, в sdkconfig.local. Не в sdkconfig: `idf.py set-target`
        удаляет sdkconfig и собирает его заново, и введённое через menuconfig
        пропадает молча. Так однажды осталась без сети плата ESP_INV.

config K57_AP_SSID
    string "SSID своей точки доступа"
    default "K57"

config K57_AP_PASS
    string "Пароль своей точки доступа"
    default "k57bridge"
    help
        Не короче 8 символов, иначе WPA2 не поднимется и точка будет открытой.

config K57_ADMIN_PASS
    string "Пароль на обновление прошивки и управление (HTTP)"
    default ""
    help
        Пользователь k57 и этот пароль спрашивает HTTP-сервер моста (web.c)
        перед обновлением прошивки, а потом и перед командами прибору со
        страницы. Пусто - тот же, что у своей точки доступа, K57_AP_PASS.

        Задаётся в sdkconfig.local, как пароль сети: в репозиторий не попадает.

endmenu
```
