/**
 * AI AGENTS: Do not edit this file directly. There is no validation or error feedback when
 * editing manually — mistakes will be silent until the file is loaded in SysConfig.
 * Use the SysConfig MCP server instead to make changes with immediate error reporting.
 *
 * These arguments were used when this file was generated. They will be automatically applied on subsequent loads
 * via the GUI or CLI. Run CLI with '--help' for additional information on how to override these arguments.
 * @cliArgs --device "F28P55x" --part "F28P55x_128PDT" --package "128PDT" --context "system" --product "C2000WARE@26.01.00.00"
 * @v2CliArgs --device "TMS320F28P550SG" --package "128PDT" --variant "TMS320F28P550SG9" --context "system" --product "C2000WARE@26.01.00.00"
 * @versions {"tool":"1.28.0+4696"}
 */

/**
 * Import the modules used in this configuration.
 */
const device_support = scripting.addModule("/driverlib/device_support.js");
const mcan           = scripting.addModule("/driverlib/mcan.js", {}, false);
const mcan1          = mcan.addInstance();

/**
 * Write custom configuration values to the imported modules.
 */
mcan1.$name = "myMCANA";

/**
 * Pinmux solution for unlocked pins/peripherals. This ensures that minor changes to the automatic solver in a future
 * version of the tool will not impact the pinmux you originally saw.  These lines can be completely deleted in order to
 * re-solve from scratch.
 */
mcan1.mcan.$suggestSolution            = "MCANB";
mcan1.mcan.mcan_rxPin.$suggestSolution = "B24, D1, E1, GPIO33";
mcan1.mcan.mcan_txPin.$suggestSolution = "GPIO19, X1";
