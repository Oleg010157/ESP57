/**
 * AI AGENTS: Do not edit this file directly. There is no validation or error feedback when
 * editing manually — mistakes will be silent until the file is loaded in SysConfig.
 * Use the SysConfig MCP server instead to make changes with immediate error reporting.
 *
 * These arguments were used when this file was generated. They will be automatically applied on subsequent loads
 * via the GUI or CLI. Run CLI with '--help' for additional information on how to override these arguments.
 * @cliArgs --device "F28P55x" --part "F28P55x_100PZ" --package "100PZ"
 * @v2CliArgs --device "TMS320F28P550SJ" --package "100PZ" --variant "TMS320F28P550SJ9"
 * @versions {"tool":"1.28.0+4696"}
 */

/**
 * These are the peripherals and settings in this configuration
 */
const MCAN1               = scripting.addPeripheral("MCAN");
MCAN1.$name               = "MyMCANA";
MCAN1.$assign             = "MCANA";
MCAN1["MCAN@_RX"].$assign = "GPIO5";
MCAN1["MCAN@_TX"].$assign = "GPIO4";
