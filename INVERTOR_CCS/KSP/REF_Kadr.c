/*
 * REF_Kadr.c
 *
 *  Created on: 25 июл. 2017 г.
 *      Author: olegs.pavlovskis
 */
#include <math.h>

#include "KSP.h"


#include "board.h"
#include "myDCAN.h"
#include "Errors.h"
#include "myADC.h"
#include "1ph_Sin.h"
#include "grid_tie.h"
#include "cla_shared.h"


extern STEND_bit sbit;


// Ключ выбора набора величин для слов 4..7. Пишет команда 634 (MBOX28.c).
// По умолчанию rms: именно они нужны на работающем мосте, а коды и мгновенные
// значения смотрят при наладке канала.
uint16_t teleSel = TELE_RMS;

static void tele_freeze_on_fault(uint16_t tele[32]);


//---------------------------------------------------------------------------
// Мощность в слово кадра с ограничением.
//
// rounding() возвращает int, а int на C28x ШЕСТНАДЦАТИБИТНЫЙ: при выходе за
// 32767 число молча заворачивается в отрицательное, и три киловатта на экране
// превращаются в минус тридцать. Для токов и напряжений это недостижимо, для
// мощности - вполне: в модели ничто не мешает поставить нагрузку в доли ома.
//---------------------------------------------------------------------------
static uint16_t power_word(float w)
{
    if (w > 32767.0f)
        w = 32767.0f;
    else if (w < -32767.0f)
        w = -32767.0f;

    return (uint16_t)(int16_t)rounding(w);
}


void send_REF_kadr()
{
    // Компактный кадр ID 140: 32 слова = 64 байта (DLC=15), с 08.10.2026.
    // До того было 24 слова = 48 байт (DLC=14), история ниже.
    //
    // Было 16 слов, и все шестнадцать заняты. Частота сети - прибор, по
    // которому судят о самой сети, держать её вне кадра нельзя, а вытеснять
    // ради неё что-то из первых шестнадцати нечего. Элемент Message RAM и так
    // 64-байтный (myMCAN.c), поэтому следующая ступень DLC не стоит ничего,
    // кроме времени на шине, а кадр 140 - самый медленный и низкоприоритетный.
    //
    // Слова 17..20 - мощности (добавлены 23.09.2026), 21..22 - постоянная
    // составляющая в трансформаторе (24.09.2026), 23 - уставка тока в сеть
    // (06.10.2026), 24..25 - запас по индексу модуляции (08.10.2026),
    // 26..31 - резерв.
    // UI (Parse140) читает по индексу, так что дописывать в них можно, не
    // трогая разбор остальных.
    uint16_t tele[32] = {0};


    tele[0] = motors[0]->error.all;
    tele[1] = motors[1]->error.all;
    tele[2] = sbit.all;
    // Слово 3 - резерв. Раньше здесь ехало слово сдвиговых регистров U4/U5
    // платы B81, которых на этой плате нет. Константа 0xFFFF, а не ноль:
    // UI читает это слово как "бит в нуле = авария" (ShowOverLoadErrors), и с
    // нулём он зажёг бы разом все индикаторы аварий несуществующих ключей.
    tele[3] = 0xFFFF;

    // Четыре канала моста, по слову на канал, все в единицах 0.1 (В или А).
    //
    // Три набора значений в кадр не помещаются, а смотреть их одновременно и
    // незачем: наладчик работает с одним. Что именно здесь лежит, говорит
    // teleSel - он же уходит в слове 13, чтобы UI подписывал поля правдой,
    // а не тем, что оператор нажал последним.
    //
    // Знаковые величины кладутся как int16_t: UI читает эти слова как short.
    switch (teleSel)
    {
    case TELE_KOD: // сырые коды АЦП, единицы кода
        tele[4] = (uint16_t)iPri_kod;
        tele[5] = (uint16_t)iSec_kod;
        tele[6] = u220_kod;
        tele[7] = (uint16_t)uSec_kod;
        break;

    case TELE_INS: // мгновенные физические значения
        tele[4] = (uint16_t)(int16_t)rounding(iPri_amp * 10.0f);
        tele[5] = (uint16_t)(int16_t)rounding(iSec_amp * 10.0f);
        tele[6] = (uint16_t)(int16_t)rounding(u220_volt * 10.0f);
        tele[7] = (uint16_t)(int16_t)rounding(uSec_volt * 10.0f);
        break;

    default: // TELE_RMS - действующие за период сети, считает CLA
        tele[4] = rounding(iPri_rms * 10.0f);
        tele[5] = rounding(iSec_rms * 10.0f);
        tele[6] = rounding(u220_rms * 10.0f);
        tele[7] = rounding(uSec_rms * 10.0f);
        break;
    }

    tele[8]  = rounding(uBat_volt * 10.0f); // напряжение АКБ, 0.1 В
    tele[9]  = core_temp;

    // Состояние автомата и код аварии - в одном слове: оба помещаются в байт,
    // а свободных слов в кадре нет.
    tele[10] = (uint16_t)(gt.State | (gt.fault << 8));
    tele[11] = rounding(gt.Iset * 100.0f); // что реально отдаём, 0.01 А rms
    tele[12] = rounding(sineB.gain);
    tele[13] = teleSel;
    tele[14] = motors[0]->flag.all;
    tele[15] = motors[1]->flag.all;

    // Измеренная частота сети, 0.01 Гц. Захват нуля U220 пропускает в u220freq
    // только период в окне U220_TIME_MIN..MAX (1ph_Sin.c), то есть примерно
    // 33.5..83.7 Гц - в uint16 это 3350..8370, переполниться нечем.
    tele[16] = rounding(u220freq * 100.0f);

    // Мощности на выходе инвертора. Считает CLA раз за период сети по паре
    // uSec и iSec, разбор - в CLA/Task1.cla.
    //
    // Единицы целые - ватт, вар и вольт-ампер: для моста на 3 кВт это доли
    // процента, а дробная часть в шестнадцати битах стоила бы потолка.
    // Коэффициент мощности - единственный дробный, у него множитель 10000:
    // он по определению не выходит за единицу, и четыре знака после запятой
    // влезают в int16 целиком.
    tele[17] = power_word(pSec);
    tele[18] = power_word(qSec);
    tele[19] = power_word(sSec);
    tele[20] = power_word(pfSec * 10000.0f);

    //-----------------------------------------------------------------
    // Постоянная составляющая в трансформаторе: что видим и чем давим.
    // Добавлено 24.09.2026, разбор - my_Files/grid_tie.txt, 3.1.
    //
    // iPri_av - среднее тока первички за окно, А. Прямая мера ухода потока:
    // ток намагничивания течёт только в первичке, и его постоянная часть -
    // ровно то, что съедает запас сердечника. Считает CLA, тем же окном,
    // что и действующие значения.
    //
    // Цена деления 0.01 А, как у gt.Iset в слове 11: ловим мы доли ампера
    // (0.1 А смещения датчика вторички уже дают четверть всего бюджета
    // mDCmax), и 0.1 А было бы грубо. Потолок слова - 327 А, канал такого
    // не покажет.
    //
    // uDCcomp - то, что мост вычитает, в милливольтах. Само mDC
    // безразмерное, и 0.0045 на экране не говорят ничего; умноженное на
    // звено это вольты, а вольты сравниваются с таблицей напрямую: 0.48 В -
    // полная ошибка мёртвого времени, 0.96 В - потолок mDCmax, меньше двух
    // периодов до насыщения.
    //
    // Умножаем на gt.Udc, а не на uBat_volt: на стенде АКБ нет вовсе, там
    // gt.UdcSrc = 0 и звено подставное (gt.UdcFixed, 48 В). Именно на это
    // число контур и делит, считая m, - значит именно оно и превращает mDC
    // в вольты. С uBat_volt поле показывало бы ноль на всём стендовом
    // прогоне. Потолок: 0.02 * 65 В = 1.3 В = 1300 единиц, в int16 с запасом.
    //-----------------------------------------------------------------
    tele[21] = (uint16_t)(int16_t)rounding(iPri_av * 100.0f);
    tele[22] = (uint16_t)(int16_t)rounding(mDC * gt.Udc * 1000.0f);

    //-----------------------------------------------------------------
    // Уставка тока в сеть - то, КУДА идёт рампа. Заняла последний резерв
    // кадра (06.10.2026).
    //
    // Без неё gt.Iset в слове 11 на главный вопрос не отвечает: стоящее
    // число значит и "доехали до уставки", и "рампа встала", и "в SYNC
    // ток держим нулём, хотя уставка поднята". Две величины рядом
    // отвечают сразу.
    //
    // Спрашивать уставку командой 632 GUI не может непрерывно: ответ на
    // неё разбирают движки Load1, и поток ответов перетирал бы то, что
    // в этот момент набирает оператор.
    //
    // Цена деления 0.01 А - та же, что у gt.Iset: оба числа попадают
    // в одно поле панели, и разные единицы у них были бы ловушкой.
    // Потолок - 327 А, как у слова 21: rounding() возвращает int,
    // а он на C28x шестнадцатибитный со знаком (см. верх файла).
    // Уставка столько не бывает, движок Load1 упирается в 25 А.
    //-----------------------------------------------------------------
    tele[23] = rounding(gt.IsetRef * 100.0f);

    //-----------------------------------------------------------------
    // Запас по индексу модуляции (08.10.2026). Кадр расширен до 64 байт,
    // DLC 15 - последней ступени FD; слова 26..31 в резерве, идут нулями.
    //
    // Слово 24 - пик |m| за период, 0.0001. Ответ на "сколько осталось до
    // аварии 64" ДО того, как она случилась: при mMax = 0.95 число 0.93
    // говорит, что следующий шаг Iset упрётся. В сети это запрос контура тока
    // до клампа (gt.mPeak), то есть в упоре видно, на сколько не хватает. В
    // острове амплитуда известна заранее - gain/2048 плюс поправка постоянки,
    // см. grid_tie_apply_uref().
    //
    // Слово 25 - тактов в упоре за прошлый период из ста (gt.satLast). Это
    // ровно то, по чему ставится авария 64: больше gt.satLimit - останов.
    // В острове ноль - там упор считает монотонный gt.gainSat.
    //-----------------------------------------------------------------
    {
        float mPk = gridMode ? gt.mPeak
                             : (float)sineB.gain * (1.0f / 2048.0f) + fabsf(mDC);

        tele[24] = rounding(mPk * 10000.0f);
        tele[25] = gridMode ? gt.satLast : 0U;
    }

    tele_freeze_on_fault(tele);

    Send_mbox_FD(2, tele, 32);
}


//---------------------------------------------------------------------------
// ЗАМОРОЗКА ПОКАЗАНИЙ НА МОМЕНТ АВАРИИ сетевого режима (08.10.2026).
//
// Зачем. После аварии ключи закрыты, и уже со следующего окна CLA все
// действующие значения, мощности и постоянка - нули: на модели тождественно,
// на железе в шумах. Оператор видит красную кнопку и нулевую форму, а то, при
// каких токах и напряжениях сработала защита, пропало. В прежних проектах
// форма в этот момент застывала, сюда это не переехало.
//
// Как. Пока аварии нет, каждый собранный кадр запоминается целиком. В
// GT_FAULT измеренные слова берутся из последнего кадра ДО аварии, то есть
// из последнего полного окна работающего моста. Снимок не нужно снимать в
// самой grid_tie_fault(): она зовётся из прерывания, а кадр, отправленный
// перед аварией, и есть снимок - ровно то, что оператор видел последним.
// Свежесть - один период кадра.
//
// Живыми остаются слова, по которым оператор управляет прибором и видит
// аварию: ошибки и флаги ключей (0..3, 14, 15 - по слову 14 горит кнопка
// питания), температура (9), состояние автомата и КОД аварии (10), уставка
// (23) - её как раз и сбавляют перед повторной попыткой. Ключ набора (13)
// заморожен вместе со словами 4..7: иначе переключение набора в аварии
// подписало бы старые числа новыми именами.
//
// Оттаивает само: сброс аварии уводит автомат из GT_FAULT, и следующий кадр
// уже живой.
//---------------------------------------------------------------------------
static void tele_freeze_on_fault(uint16_t tele[32])
{
    static uint16_t last[32];
    static uint16_t valid = 0;

    // Измеренные слова, которые в аварии показываются на её момент
    // (24..25 сюда не входят - их защёлкивает сама авария, см. ниже)
    static const uint16_t frozen[] = {4, 5, 6, 7, 8, 11, 12, 13, 16,
                                      17, 18, 19, 20, 21, 22};
    uint16_t i;

    if (gt.State != GT_FAULT)
    {
        for (i = 0; i < 32; i++)
            last[i] = tele[i];
        valid = 1;
        return;
    }

    // Авария с первого же кадра после старта - показывать нечего, идёт как есть
    if (valid)
    {
        for (i = 0; i < sizeof(frozen) / sizeof(frozen[0]); i++)
            tele[frozen[i]] = last[frozen[i]];
    }

    // Запас по m - не из последнего кадра, а защёлкнутый самой аварией:
    // кадр идёт раз в 50 мс, упор раскручивается быстрее. См. faultMPeak
    // в grid_tie.h.
    tele[24] = rounding(gt.faultMPeak * 10000.0f);
    tele[25] = gt.faultSat;
}






