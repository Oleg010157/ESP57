/*
 * plant_sim.c
 *
 *  Created on: 23.09.2026
 *      Author: Oleg Pavlovsky
 *
 *  Численная модель силовой части: АКБ - H-мост - трансформатор - нагрузка,
 *  а в сетевом режиме вместо нагрузки сеть.
 *
 *  Зачем она. Отладка алгоритмов без силовой части: контур тока, автомат
 *  подключения, контур подавления постоянной составляющей и защиты замыкаются
 *  на числа в ОЗУ и ведут себя так же, как повели бы себя на железе. Раньше
 *  модель жила внутри grid_tie.c, работала только при замкнутом контакторе и
 *  знала лишь связку L-R до сети - то есть режим АИН с нагрузкой не проверялся
 *  вообще. Параметры крутили в окне Watch.
 *
 *  Теперь это отдельный модуль, работающий в ОБОИХ режимах моста, а параметры
 *  задаются из GUI таблицей CanTxFiles/Модель.ini.
 *
 *  Подробное описание и порядок опытов - my_Files/plant_sim.txt
 */

#include "board.h"
#include "F28P55x_Device.h"

#include "KSP.h"        // motors[] - состояние ключей
#include "myADC.h"      // kadcf - масштабы каналов АЦП
#include "cla_shared.h" // измеренные величины всех каналов
#include "1ph_Sin.h"    // cmpaA / cmpaB - то, что реально стоит в компараторах
#include "grid_tie.h"   // gt.acContactor, gt.uGrid, gt.iSign
#include "plant_sim.h"

struct Plant sim;

// TBCLK1 = 150 МГц / 2 (HSPCLKDIV = 2 по сбросу) = 75 МГц, режим UP_DOWN даёт
// 2*TBPRD тактов на период. Отсюда Ts = TBPRD / 37.5e6. Та же константа
// и в grid_tie.c: там она нужна контуру, здесь модели.
#define TB1_TICKS_PER_SECOND_HALF 37.5e6f

// Нижний предел индуктивности в знаменателе. Ноль там - это мгновенный скачок
// тока до бесконечности за один такт, то есть NaN во всех шести каналах и
// вставший прибор. Один микрогенри вместо нуля даёт заведомо быстрый, но
// конечный переходный процесс - в нём хотя бы видно, что параметр не задан.
#define L_MIN 1e-6f

//---------------------------------------------------------------------------
// Начальное состояние модели.
//
// САМО ЖЕЛЕЗО ЗДЕСЬ БОЛЬШЕ НЕ ОПИСЫВАЕТСЯ. Напряжение звена, коэффициент
// трансформации, рассеяние, сопротивление обмоток, индуктивность
// намагничивания и номинал нагрузки с 25.09.2026 приходят из ПАСПОРТА
// (my_Files/power_par.h) - через power_par_apply(), которую main() зовёт
// после этой функции.
//
// Смысл переезда в том, что модель перестала быть моделью ОДНОГО стенда.
// Вписав в паспорт чужой инвертор, на ней можно посмотреть, вытянет он
// уставку или упрётся в потолок, - не имея этого инвертора на столе.
//
// Нагрузка по умолчанию ВЫКЛЮЧЕНА, и это не осторожность, а совместимость:
// при холостом ходе и разомкнутом контакторе модель ведёт себя ровно так,
// как прежняя (ток вторички тождественно ноль), и прогнанные на ней опыты
// из grid_tie.txt повторяются числом в число. Паспорт задаёт лишь НОМИНАЛ
// резистора, а включает его оператор строкой "Нагрузка" в Модель.ini.
//---------------------------------------------------------------------------
void plant_sim_init(void)
{
    sim.on       = 1U; // железа нет, работаем на модели
    sim.loadType = LOAD_OFF;

    sim.Lload = 0.0f;

    sim.uDCinject = 0.0f;

    sim.iSec = 0.0f;
    sim.iMag = 0.0f;

    sim.m       = 0.0f;
    sim.uBridge = 0.0f;
    sim.uSecOut = 0.0f;
    sim.iPri    = 0.0f;
    sim.iBat    = 0.0f;
    sim.Ts      = 200e-6f;
}

//---------------------------------------------------------------------------
// Физическая величина обратно в коды АЦП.
//
// Нужно ради ключа телеметрии TELE_KOD: в этом положении кадр 140 везёт сырые
// коды, и на модели они обязаны сойтись с мгновенными значениями, иначе
// переключение набора выглядит как поломка канала.
//
// Масштаб нулевой до первого floatKadc() и у нетарированного канала - тогда
// отдаём ноль, а не бесконечность.
//---------------------------------------------------------------------------
static inline int16_t to_kod(float value, float k)
{
    if ((k > 1e-9f) || (k < -1e-9f))
        return (int16_t)(value / k);

    return 0;
}

//---------------------------------------------------------------------------
// Такт модели. Вызывается из INT_myADCB_1_ISR сразу за чтением токов с АЦП и
// ДО такта управления - см. комментарий в plant_sim.h.
//
// Уравнения (всё приведено ко вторичке, то есть к стороне 220 В):
//
//     m        = (cmpaB - cmpaA) / TBPRD          что стоит в компараторах
//     uBridge  = n * m * Udc + uDCinject          что мост приложил
//     di/dt    = (uBridge - emf - R*i) / L        ток вторички
//     iMag    += uBridge * Ts / Lmag              ток намагничивания
//     iPri     = n * (iSec + iMag)
//     iBat     = m * iPri                         баланс мощности моста
//
// Ветвь намагничивания стоит у ЗАЖИМОВ МОСТА, а не за рассеянием: это Г-схема
// замещения, точная при отнесении всего рассеяния к выходу. Разница с Т-схемой
// - падение на рассеянии, единицы вольт из трёх сотен, и ради неё пришлось бы
// решать систему из двух связанных состояний в каждом такте.
//---------------------------------------------------------------------------
// ЛЕЖИТ В .TI.ramfunc с 25.09.2026. Раньше не лежала, и довод был такой:
// секция привязана к одному блоку RAMLS0 (0x800 слов), модель туда не влезает,
// а отбирать место у контура тока ради неё неправильно - на живом железе
// модель выключена и выходит по первому же сравнению.
//
// Обе половины довода отпали. Секция с 24.09.2026 живёт в RAMGS0, где
// свободно больше 0x1600 слов. А "лишние такты безразличны" опровергнуто
// замером: при включённой модели sine_Time 9.3 мкс, при выключенной 6.3 -
// три микросекунды из флеша, шестая часть всего такта в 200 мкс. На стенде
// это столько же мешает, сколько мешало бы в сети: обработчик держит запрет
// прерываний, пока считает, а стенд - это то место, где всё и отлаживают.
#pragma CODE_SECTION(plant_sim_step, ".TI.ramfunc");
void plant_sim_step(void)
{
    if (!sim.on)
        return;

    float tbprd = (float)EPwm1Regs.TBPRD;

    sim.Ts = tbprd * (1.0f / TB1_TICKS_PER_SECOND_HALF);

    //-----------------------------------------------------------------
    // 1. Что мост приложил за ПРОШЕДШИЙ такт.
    //
    // Берём не gt.m и не sineB.gain, а сами компараторы: там лежит то, что
    // отработало железо, вместе с усечением float->uint16. Одна формула на
    // оба режима моста - и контур тока, и sine_invertor2() оставляют в cmpaA
    // и cmpaB значения, разность которых и есть индекс модуляции.
    //-----------------------------------------------------------------
    sim.m = (tbprd > 1.0f) ? (((float)cmpaB - (float)cmpaA) / tbprd) : 0.0f;

    //-----------------------------------------------------------------
    // ДАТЧИКИ МЕРЯЮТ НАЧАЛО ТАКТА, поэтому оба состояния - iSec и iMag -
    // остаются нетронутыми до самого конца функции, а их приращения копятся
    // здесь. Публикуется то, что было на входе в такт; состояние
    // продвигается после публикации.
    //
    // Это не мелочь. АЦП запускается по TBCTR = PRD, то есть в момент, когда
    // приложенное за прошлый период напряжение уже отработало, а новое ещё не
    // встало. Отдай наружу ток КОНЦА такта вместе с напряжением НАЧАЛА - и
    // между ними ляжет перекос в один отсчёт, 3.6 градуса при ста точках на
    // период. На форме его не видно, а на мощности видно сразу: чисто
    // активная нагрузка давала реактивную мощность в минус шесть процентов
    // от полной и коэффициент мощности 0.98 вместо единицы. Поймано на цели
    // 23.09.2026, как раз при первом прогоне мощностей.
    //-----------------------------------------------------------------
    float dISec = 0.0f;
    float dIMag = 0.0f;

    // Ключи закрыты - обмотка разомкнута, и оба тока равны нулю по
    // определению. Остаточный поток сердечника модель не помнит: после
    // включения ключей намагничивание начинается с нуля.
    if (motors[0]->flag.bit.pwm_On == 0)
    {
        sim.m       = 0.0f;
        sim.iSec    = 0.0f;
        sim.iMag    = 0.0f;
        sim.uBridge = 0.0f;
        sim.uSecOut = 0.0f;
        sim.iPri    = 0.0f;
        sim.iBat    = 0.0f;
    }
    else
    {
        sim.uBridge = sim.n * sim.m * sim.Udc + sim.uDCinject;

        //-----------------------------------------------------------------
        // 2. Ток вторички.
        //
        // Контактор замкнут - нагрузкой служит СЕТЬ, и в цепи только
        // рассеяние трансформатора: ток определяется разностью напряжений
        // моста и сети. Нагрузка при этом не моделируется - в сети мост
        // работает источником тока, и своя нагрузка на его выходе к делу
        // отношения не имеет.
        //
        // Контактор разомкнут - мост работает на собственную нагрузку
        // (режим АИН), и это единственный режим, где нагрузка вообще есть.
        //-----------------------------------------------------------------
        float r    = sim.Rwind;
        float l    = sim.Lleak;
        float emf  = 0.0f;
        float dIdt = 0.0f;

        if (gt.acContactor)
        {
            emf = gt.uGrid;
        }
        else if (sim.loadType == LOAD_OFF)
        {
            // Холостой ход: цепи нет. Ток вторички тождественно ноль, но
            // ток намагничивания ниже считается - это и есть ток холостого
            // хода трансформатора, он течёт и без нагрузки.
            sim.iSec = 0.0f;
            r        = 0.0f;
            l        = -1.0f; // признак "интегрировать нечего"
        }
        else
        {
            r += sim.Rload;
            if (sim.loadType == LOAD_RL)
                l += sim.Lload;
        }

        if (l >= 0.0f)
        {
            if (l < L_MIN)
                l = L_MIN;

            // Падения считаются по току НАЧАЛА такта - тому, что реально тёк,
            // пока к обмотке было приложено uBridge. Само состояние
            // продвигается в самом конце функции, после публикации.
            dIdt  = (sim.uBridge - emf - r * sim.iSec) / l;
            dISec = dIdt * sim.Ts;
        }

        //-----------------------------------------------------------------
        // 3. Ток намагничивания - интеграл приложенного напряжения за вычетом
        //    падения на обмотке.
        //
        // Ради него модель и переписана: постоянная составляющая в uBridge
        // уходит сюда и намагничивает сердечник, ровно как поток на железе.
        // Контур подавления DC ловит её в среднем токе первички.
        //
        // ПАДЕНИЕ НА ОБМОТКЕ ДОБАВЛЕНО 24.09.2026, и это не косметика.
        // Раньше здесь стоял чистый интеграл, без единого члена с
        // сопротивлением, - то есть объект без потерь вовсе. В паре с
        // интегратором регулятора это давало ровно нулевое затухание, и
        // контур на холостом ходу качался ВЕЧНО: замерено 1.03 Гц при
        // размахе около 5 А постоянки, разбор - grid_tie.txt, 3.1.6.
        //
        // На железе так не бывает: ток намагничивания течёт по первичной
        // обмотке и её сопротивление видит. Нулевое затухание было
        // артефактом модели, а не свойством схемы, и модель этим пугала
        // сильнее, чем следует. С поправкой zeta выходит 0.028 - мало, но
        // не ноль, и сходится с оценкой по железу из 3.1.6.
        //
        // Вычитается падение от СВОЕГО тока, а не от полного тока первички.
        // Строго по Г-схеме напряжение в узле зависит от обеих ветвей сразу,
        // и это связало бы два состояния в одну систему - ровно то, от чего
        // отказались при выборе схемы замещения (см. шапку функции). Для
        // динамики постоянной составляющей разницы нет: у тока вторички
        // постоянной составляющей нет, в узел он по этой части ничего не
        // вносит.
        //
        // СЛЕДСТВИЕ ДЛЯ ОПЫТА С uDCinject: ток намагничивания больше не
        // растёт прямой без предела, а выходит на uDCinject/Rwind с
        // постоянной времени Lmag/Rwind = 2.8 с. Так и на железе: предел
        // задаёт сопротивление обмотки. Просто на железе сердечник насыщается
        // задолго до этого предела, а насыщения в модели по-прежнему нет.
        //-----------------------------------------------------------------
        if (sim.Lmag > L_MIN)
            dIMag = (sim.uBridge - sim.Rwind * sim.iMag) * (sim.Ts / sim.Lmag);
        else
            sim.iMag = 0.0f;

        //-----------------------------------------------------------------
        // 4. Что увидели бы датчики - всё по началу такта, см. выше.
        //
        // Напряжение на выходе: из приложенного вычтены падения на обмотке.
        // При разомкнутом контакторе это в точности напряжение на нагрузке,
        // а при замкнутом - напряжение сети плюс падение на её стороне.
        //-----------------------------------------------------------------
        sim.uSecOut = sim.uBridge - sim.Rwind * sim.iSec - sim.Lleak * dIdt;
        sim.iPri    = (sim.iSec + sim.iMag) * sim.n;

        // Баланс мощности идеального моста: P = m*Udc*iPri = Udc*iBat.
        // Пульсация 100 Гц в токе АКБ отсюда и берётся - она не добавлена
        // руками, а следует из произведения двух синусоид.
        sim.iBat = sim.m * sim.iPri;
    }

    //-----------------------------------------------------------------
    // 5. Подмена измерений.
    //
    // Пишутся все шесть измеряемых величин разом - ровно те же переменные, в
    // которые кладёт отсчёты АЦП сам обработчик (xfmr_currents_from_adc и
    // adc_late_sample). Поэтому подмена и не требует от остального кода
    // ничего: ни ключей, ни ветвлений.
    //
    // Коды считаются обратным пересчётом через те же kadcf и gt.iSign, по
    // которым xfmr_currents_from_adc() и Cla1Task1 переводят коды в величины.
    //-----------------------------------------------------------------
    iPri_amp = sim.iPri;
    iSec_amp = sim.iSec;
    iPri_kod = to_kod(sim.iPri, gt.iSign * kadcf.iPri);
    iSec_kod = to_kod(sim.iSec, gt.iSign * kadcf.iSec);

    uSec_volt = sim.uSecOut;
    uSec_kod  = to_kod(sim.uSecOut, kadcf.uSec);

    uBat_volt = sim.Udc;
    uBat_kod  = to_kod(sim.Udc, kadcf.uBat);

    iBat_amp = sim.iBat;
    iBat_kod = to_kod(sim.iBat, kadcf.iBat);

    //-----------------------------------------------------------------
    // 6. И только теперь - состояние на конец такта. Всё, что выше, уже
    // отдано наружу как показания датчиков на его начало.
    //-----------------------------------------------------------------
    sim.iSec += dISec;
    sim.iMag += dIMag;
}
