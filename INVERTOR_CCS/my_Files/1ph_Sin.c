/*
 * 1ph_Sin.c
 *
 *  Created on: 26.02.2025
 *      Author: Oleg Pavlovsky
 *  модифицирован 03.10.2025  Олег Павловский
 *  модифицирован 27.07.2026  Олег Павловский  под проект К1
 *  модифицирован 07.08.2026  Олег Павловский  под проект К55
 */

/* Данный файл представляет программный код для реализации мостового однофазного инвертора.
*  Мост реализован на двух EPWM модулях - EPWM1 (фаза А)и EPWM2 (фаза B).
*  Запуск EPWM2 синхронный с запуском EPWM1.
*/

#include "board.h"
#include <math.h>
#include "F28P55x_Device.h" // Основные определения регистров и структуры устройства

#include "KSP.h"
#include "hw_mcan.h"
#include "myDCAN.h"
#include "myADC.h" // kadcf - масштабы каналов АЦП для синхронизации по амплитуде
#include "cla_shared.h" // измеренные величины всех каналов АЦП

#include "1ph_Sin.h"
#include "grid_tie.h"  // сетевой режим: отдача мощности в сеть
#include "plant_sim.h" // модель силовой части вместо железа

//---------------------------------------------------------------------
// Пользовательские настройки (измените значения по необходимости)
//---------------------------------------------------------------------

//
// Globals
//
extern float     Tpwm;
extern STEND_bit sbit;
extern int       rgStrob_enable;

// Метод формирования синусоиды остался один. Переменная сохранена только ради
// команды CAN 622, которая её читает и пишет; на выбор кода она больше
// не влияет. Метод 1 удалён 17.08.2026 - см. комментарий ниже и grid_tie.txt.
uint16_t sine_metod = 2;
uint16_t cmpaA, cmpaB;

float    duty;                 // Значение скважности ШИМ (в тактах таймера)
uint16_t sineTick = 0;         // счётчик PWM прерываний
uint16_t tim0S, sine_Time;     // dbg переменные для контроля времени выполнения программы
uint16_t sine_freq  = 50;      // Выходная частота синусоидального сигнала (от 40 до 1000 Гц)
float    sine_amp   = 1;       // амплитуда напряжения синусоидального сигнала Uref/Vin ( от 0 до 1)
uint16_t pwm_period = 60000;   //  период ШИМ в мкс
float    sine_angle;           // текущий угол синусоиды в радианнах:  y=sin(x)
float    sine_step = PI2 / 20; //(PI2 * 50.0f /1000.0f);// шаг приращения угла в радианах ( зависит от частоты синуса и частоты ШИМ)
float    test[32];
uint16_t index  = 0;      // номер от 0 до количества точек периодов ШИМ синусоиды
uint16_t spwmHz = 1000;   //заданная частота  ШИМ в Гц , глобальный параметр. Изменяется через команды CAN
float    sine0  = PI / 2; // регулируемое смещение фазы синусоиды
uint16_t cmpaA;
uint16_t cmpaB;
float duty; // Значение скважности ШИМ (в тактах таймера TBCLK)

//DBG
// upDown - режим счёта таймера, которому синусоида отдаёт pwm_period, см.
// struct sine в 1ph_Sin.h. EPWM6 под sineA считает только вверх, EPWM1 под
// sineB - вверх-вниз (CTRMODE = UP_DOWN), и период у него вдвое длиннее TBPRD.
struct sine sineA = {.resolution = 256, .freq = 50, .gain = 1800};              // EPWM6
struct sine sineB = {.resolution = 100, .freq = 50, .gain = 1800, .upDown = 1}; // EPWM1

// iPri_* / iSec_* переехали в CLA/cla_shared.c - туда, где объявлены все шесть
// каналов АЦП сразу. Пишет их по-прежнему CPU, здесь же, в прерывании ADCB.
// Накопители RMS остаются локальными: наружу они не нужны.
#pragma CODE_SECTION(xfmr_currents_from_adc, ".TI.ramfunc");
static void xfmr_currents_from_adc(void)
{
    iPri_kod = (int16_t)AdcbResultRegs.ADCPPB1RESULT.bit.PPBRESULT;
    iSec_kod = (int16_t)AdcbResultRegs.ADCPPB2RESULT.bit.PPBRESULT;
    iPri_amp = gt.iSign * kadcf.iPri * (float)iPri_kod;
    iSec_amp = gt.iSign * kadcf.iSec * (float)iSec_kod;
}

// Действующие значения (iPri_rms, iSec_rms, u220_rms, uSec_rms) считает CLA,
// Cla1Task1. Здесь стояла adc_rms_update() - четыре умножения с накоплением
// каждый такт плюс четыре корня с делением раз за период сети, всё в
// прерывании контура тока. Это ровно та работа, ради которой CLA и ставят.
//
// CPU остались мгновенные значения токов: их потребляет контур тока
// немедленно, на EOC1, а CLA отрабатывает только к EOC3.
//---------------------------------------------------------------------------------------------------
#if Strob_rg // применяется для отладки метода формирования синусоиды

extern float rgStrob;

float angleOld   = 0;
int   strobIndex = 0; // строб номера  ШИМ периода в последовательности синусоиды

#endif // if Strob_rg

//-------------------------------------------------------------------------------------------------
/* sine_invertor1 УДАЛЁН 17.08.2026.
 *
 * Это был метод, где в каждой полуволне модулирует только одно плечо, а второе
 * стоит с постоянно открытым нижним ключом. Вдвое меньше переключений - и
 * фатальный для трансформатора порок: КАЖДАЯ ПОЛУВОЛНА ФОРМИРУЕТСЯ СВОИМ
 * ЖЕЛЕЗОМ. Положительная - плечом A, отрицательная - плечом B. Любое различие
 * между плечами (задержки драйверов, время выключения ключей, Vce(sat) нижнего
 * ключа, тепловая точка) попадает целиком в одну полуволну и не попадает
 * в другую, то есть превращается в постоянную составляющую напряжения.
 * Трансформатор её интегрирует в поток и уходит в насыщение.
 *
 * Порядок величины: мёртвое время 2 мкс на периоде ШИМ 200 мкс при Udc = 48 В
 * даёт вольт-секундную ошибку 0.48 В. Расхождение плеч всего в 10 % от неё -
 * это 48 мВ постоянной составляющей на первичке, 336 мВ на вторичке.
 *
 * Вторая причина: знак U_AB жёстко привязан к знаку опорной синусоиды, мост
 * не может выдать напряжение против опоры. Замкнутому контуру тока это нужно
 * регулярно, и без этого он упирается в ОДНОСТОРОННЕЕ ограничение - а это само
 * по себе машина по производству постоянной составляющей.
 *
 * Разбор целиком - my_Files/grid_tie.txt, раздел 9. Код - в истории git.
 */

#pragma CODE_SECTION(sine_invertor2, ".TI.ramfunc");

void sine_invertor2(struct sine *s)
{
    /* В этом методе в режиме ШИМ работают все четыре ключа.
     * ключи фазы А (EPWM1) модулируются скважностью = duty, 
     * а ключи фазы В (EPWM6) модулируются скважностью = (1-duty)
     * Вычисление duty происходит в прерывании которое запускается при достижении
     * счётчиком значения: TBCNT =  pwm_period, а загрузка нового значения скважности в 
     * компаратор CMPA происходит позже когда TBCNT = 0.
    */

    // вычисление нового значения скважности для ШИМ.
    // Скважность нормируется в диапазоне от 0 до 1 и умножается на коэффициент амплитуды amp,
    // который тоже нормируется от 0 до 1 -> amp = Uab/Vin;  где Uab - выходное напряжение, а
    // Vin - входное напряжение от АКБ

    // нормируем скважность в диапазоне от 0 до 1
    duty           = (0.5f * sinf(s->angle + s->offset) + 0.5f);
    float tbperiod = s->gain / 2048.0f * s->pwm_period;

    // Оба компаратора считаются НЕЗАВИСИМО из float.
    //
    // Раньше было cmpaB = tbperiod - EPwm1Regs.CMPA, то есть вычитание из уже
    // УСЕЧЁННОГО регистра. Присваивание float->uint16 усекает к нулю, и такая
    // разность двух усечений даёт односторонний сдвиг в полкода:
    //   cmpaB - cmpaA = tbperiod*(2*duty-1) + 2*frac - 0.5,  E[2*frac-0.5] = +0.5
    // При TBPRD = 7500 это 6.7e-5 от Udc: 3 мВ на первичке, ~22 мВ на вторичке.
    // Для активной нагрузки пренебрежимо, а трансформатор интегрирует это
    // в поток. При независимом расчёте смещения обоих усечений одинаковы
    // и в разности сокращаются.
    //
    // Порядок (1-duty) для плеча A и duty для плеча B, а не наоборот:
    // доля открытого состояния плеча = 1 - CMPA/TBPRD, поэтому
    //   U_AB = (cmpaB - cmpaA)/TBPRD * Udc = tbperiod/TBPRD * sin(angle) * Udc
    // то есть ПОЛОЖИТЕЛЬНЫЙ синус даёт положительное напряжение - как в
    // прежнем sine_invertor1. В старой редакции знак был обратным, и переход
    // на этот метод развернул бы мост на 180 градусов относительно dacb,
    // к которому привязан контур фазы.
    // Поправка постоянной составляющей. Сдвигает компараторы НАВСТРЕЧУ друг
    // другу, ровно на столько, чтобы к напряжению моста добавилось mDC*Udc:
    // U_AB = (cmpaB - cmpaA)/TBPRD * Udc, значит каждому по mDC*TBPRD/2.
    //
    // Добавлено 23.09.2026. До того контур подавления в острове не работал
    // вовсе - и не считался, и применять его было некуда. Трансформатору же
    // безразлично, каким режимом ему наливают вольт-секунды; разбор -
    // grid_tie.txt, 3.1.
    //
    // Ограничение обязательно: при mDC на потолке сдвиг равен 0.01*TBPRD,
    // то есть 75 тактов, и у края синусоиды tbperiod*(1-duty) уже нулевое.
    // Без клампа разность ушла бы в минус, а присваивание uint16 превратило
    // бы её в шестьдесят пять тысяч - полностью открытое плечо.
    float dc = 0.5f * mDC * (float)s->pwm_period;

    float ca = tbperiod * (1.0f - duty) - dc;
    float cb = tbperiod * duty + dc;
    float top = (float)s->pwm_period;

    ca = (ca < 0.0f) ? 0.0f : ((ca > top) ? top : ca);
    cb = (cb < 0.0f) ? 0.0f : ((cb > top) ? top : cb);

    cmpaA = (uint16_t)ca; // ШИМ для верхнего ключа фазы A
    cmpaB = (uint16_t)cb; // ШИМ для верхнего ключа фазы B

    // DINT/EINT вокруг записи убраны: оба регистра теневые и загружаются
    // одновременно по TBCTR = 0, так что пара атомарна относительно ШИМ сама
    // по себе. А EINT посреди обработчика открывал окно вложенных прерываний.
    EPwm1Regs.CMPA.bit.CMPA = cmpaA;
    EPwm2Regs.CMPA.bit.CMPA = cmpaB;

    // вычисление нового угла синусоиды и ограничение в диапазоне от -PI до PI
    s->angle = asut(s->angle + s->step);
}

//-----------------------------------------------------------------------------------
/* программа для вычисления и изменения частоты ШИМ для формирования синусоиды. 
* pwmfreq - заданная частота  ШИМ , глобальный параметр. Изменяется через команды CAN
* sine_freq - заданная частота  синусоиды в Гц, глобальный параметр. Изменяется через команды CAN
* sine_step - расчитанное приращение угла синусоиды за один период ШИМ.
* pwm_period - расчитанное значение TBPRD. 
*/

void spwmCLKDIV(uint16_t div)
{
    EALLOW;
    SysCtl_disablePeripheral(SYSCTL_PERIPH_CLK_TBCLKSYNC);
    EPwm1Regs.TBCTL.bit.CLKDIV = div;
    EPwm2Regs.TBCTL.bit.CLKDIV = div;

    //   EPwm1Regs.DBFED.all =  (Deadband >> div);
    //   EPwm1Regs.DBRED.all = (Deadband >> div);
    SysCtl_enablePeripheral(SYSCTL_PERIPH_CLK_TBCLKSYNC);
    EDIS;
}
//--------------------------------------------------------------------------------------
uint16_t daca  = 2048; // dbg
uint16_t dacb  = 2048; // dbg

//--------------------------------------------------------------------------------------
// dbg  Выбор сигнала на единственный свободный аналоговый выход кристалла.
//
// Аналоговых выходов всего два, и оба заняты: DACA формирует daca - имитацию
// сети, которая физически заведена на вход АЦП A0, освободить её на стенде
// нельзя. Остаётся нижний ЦАП CMPSS1 на пине A1/B7/D11 (HSEC 11).
//
// dacb туда выводится только ради осциллографа. Как ЧИСЛО он нужен всегда -
// по нему в INT_U220_zero_ECAP_ISR идёт подстройка фазы, - но это отдельно
// от пина. Значит пин можно забрать под ток, ничего не сломав.
//
// Обе переменные крутятся в отладчике на живой цели и задаются из GUI
// строками таблицы ЦАП.ini (команды 672 и 673, таблица gtPars в
// KSP/MBOX28.c). Номер источника - список в комментарии к dacDbgSrc ниже.
//
// МАСШТАБ ОДИН НА ВСЕ ИСТОЧНИКИ, и это сознательно. Заводить свой множитель
// каждому сигналу значит держать таблицу физических диапазонов, угаданных
// заранее; угадана она будет неверно, и оператор всё равно полезет её править.
// Здесь он правит одно число рядом с номером источника:
//
//     код_на_пине = 2048 + kDacDbg * величина
//
// kDacDbg - это КОДОВ НА ЕДИНИЦУ выбранной величины, и единица меняется
// вместе с источником: у токов ампер, у напряжений вольт, у индекса
// модуляции и ошибки фазы - единица как она есть. Размах отсюда следует, а
// не задаётся: полшкалы 2048 кодов, упор наступает на 2048/kDacDbg. Обратный
// счёт - kDacDbg = 2048/размах; таблица GUI хранит его умноженным на 10,
// то есть 20480/размах. Разбор с примерами - в шапке строки kDac_x10
// в CanTxFiles/ЦАП.ini.
//
// Разумные kDacDbg: ток первички ~50 (шкала +-40 А), ток вторички ~200
// (+-10 А), напряжения ~5 (+-400 В), индекс модуляции 2048 (+-1),
// ошибка фазы ~2000. Источник 0 - исключение, там уже готовые коды ЦАП.
//--------------------------------------------------------------------------------------
uint16_t dacDbgSrc = 0;     // что выводить, см. switch в sine_invertor_ISR:
                            //  0 dacb      синусоида ШИМ, коды 0..4095
                            //  1 iPri_amp  ток первички, А
                            //  2 iSec_amp  ток вторички, А
                            //  3 gt.m      индекс модуляции, -1..+1
                            //  4 gt.iref   заданный ток вторички, А
                            //  5 gt.ierr   ошибка тока, А
                            //  6 gt.uSec   требуемое U вторички, В
                            //  7 gt.uGrid  U сети на вторичке, В
                            //  8 mDC    поправка постоянной составляющей
                            //  9 u220_volt измеренное U сети, В
                            // 10 phaseErr  ошибка фазы, единицы sin()
                            // 11 iBat_amp  ток АКБ, А
float    kDacDbg   = 50.0f; // код на единицу величины, см. формулу выше
uint16_t dacDbg    = 2048;  // dbg что реально ушло на пин

//--------------------------------------------------------------------------------------
// Масштаб под выбранный сигнал.
//
// Масштаб и источник - не два независимых числа. 50 кодов на единицу разумны
// для тока первички и бессмысленны для индекса модуляции, у которого вся
// шкала укладывается в +-1: на пине вышла бы прямая по середине. Поэтому
// смена источника тянет за собой свой масштаб, и оператор не обязан помнить
// таблицу из двенадцати чисел.
//
// Это ОТПРАВНАЯ ТОЧКА, а не запрет: kDacDbg правится следом строкой ниже в
// той же таблице, и до следующей смены источника его никто не тронет. Потому
// и сравнение с last - повторная посылка того же источника (а таблица шлёт
// строку при каждом щелчке) не должна стирать подобранный руками масштаб.
//
// Числа - 2048, делённое на ожидаемый размах величины. Потолок 3276: в
// таблицу GUI значение едет умноженным на 10 и обязано влезть в int16.
//--------------------------------------------------------------------------------------
static const float kDacDbgDef[] = {
       1.0f,  //  0 синусоида ШИМ - идёт кодами мимо масштаба
      51.2f,  //  1 ток первички,          +-40 А
     204.8f,  //  2 ток вторички,          +-10 А
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    2048.0f,  // 10 ошибка фазы,            +-1
      20.48f  // 11 ток АКБ,             +-100 А
};

void dacDbg_scale_default(void)
{
    static uint16_t last = 0xFFFFU; // заведомо не номер источника: первая же
                                    // команда обязана поставить свой масштаб

    if (dacDbgSrc == last)
        return;
    last = dacDbgSrc;

    if (dacDbgSrc < (sizeof(kDacDbgDef) / sizeof(kDacDbgDef[0])))
        kDacDbg = kDacDbgDef[dacDbgSrc];
}

//--------------------------------------------------------------------------------------
//  Телеметрия быстрого кадра (ID 103, буфер 1) для Wscope(запись в файл ) или Oscilloscope(реальный осциллограф).
//
// Кадров два, и выбирает их команда CAN 1001 (кнопка F2 в окне, поле "F2 Кадр"):
//
//   data3 = 1   F1_convertor   4 слова, 8 байт.  Три величины на выбор telSrc
//                              плюс счётчик тактов. Таблица наборов - в
//                              grid_tie.txt, раздел 6.2.
//   data3 = 4   F3_convertor   16 слов, 32 байта. Полная лента: весь контур
//                              тока и ВСЕ ШЕСТЬ измеряемых величин тракта.
//                              Раскладка - у самой отправки, ниже по файлу.
//
// Формат обоих менять можно только тремя местами разом: прошивка, разбор в
// Motor_Control (Oleg/Kadr60.cs, ProcessFrame103) и настройки каналов Wscope
// (bin/Wscope/F3_convertor.ini). Приёмная сторона читает по НОМЕРУ СЛОВА,
// имён в кадре нет.
//
// ЧЕТВЁРТОЕ СЛОВО - sineTick, и это не украшение. Send_mbox_FD молча пропускает
// кадр, если буфер занят передачей предыдущего, а пропуск в ленте неотличим
// от настоящей паузы в сигнале: Wscope нарисует сжатый по времени участок и
// это будет выглядеть как реальная динамика. По разрывам sineTick пропуск
// виден сразу. Сколько их и откуда - grid_tie.txt, раздел 6.2.
//
// Масштабы каналов ЖЁСТКО ЗАШИТЫ, а не вынесены в переменные, и намеренно:
// приёмная сторона декодирует по фиксированной таблице, и масштаб, который
// покрутили в отладчике и забыли, даст молча неверные числа на графике.
// Таблица - в grid_tie.txt, раздел 6.2.
//--------------------------------------------------------------------------------------
uint16_t telSrc = 0; // набор каналов, таблица в grid_tie.txt 6.2:
                     // 0 = как было, 1 = контур тока,
                     // 2 = трансформатор и DC, 3 = синхронизация
uint16_t telDiv = 1; // прореживание: 1 = каждое прерывание, N = каждое N-е

// dbg Счётчик тактов, в которых обработчик дошёл до "поздних" каналов ADCA
// раньше, чем те преобразовались. В норме стоит в нуле.
//
// КАК СЧИТАЕТСЯ ЗАПАС. Обработчик входит по EOC1 модуля ADCB, это 2.4 мкс от
// пуска преобразований; EOC3 модуля ADCA наступает на 4.8. Значит проверка
// обязана произойти не раньше чем через 2.4 мкс ПОСЛЕ ВХОДА. Стоит она в
// хвосте обработчика, и при нынешних 6 мкс такта запас около двух микросекунд.
//
// ОПАСНОСТЬ ТУТ ОБРАТНАЯ ОБЫЧНОЙ - не "не успели", а "успели слишком рано".
// Ускорение обработчика придвигает проверку к 4.8 мкс, а не отодвигает.
// 25.09.2026 это померили: CPU1_FLASH на пробу собрали с -O2, и такт упал до
// 3.98 мкс (5.14 с моделью), то есть запас сжался с двух микросекунд до
// неполной одной. Счётчик и тогда стоял в нуле, но поля осталось мало.
// Оптимизацию вернули в off по другой причине - удобство отладки, - однако
// цифра известна: включат её снова, и запас будет такой.
//
// Съедает запас ВСЁ, что добавляют в обработчик ДО этой проверки. То, что
// после неё (быстрый кадр F3, запуск CLA), на запас не влияет.
//
// Растёт - смотреть sine_Time: такт стал слишком коротким, и три канала
// поехали на такт назад. Разбор - у места проверки в INT_myADCB_1_ISR.
uint16_t adcLate = 0;

// dbg Счётчик кадров, не ушедших из-за занятого буфера 1. Считает пропуски
// НА СТОРОНЕ МК и тем разделяет две совершенно разные болезни:
//   telDrop растёт, в ленте дырки  -> не успевает шина или буфер
//   telDrop = 0,     в ленте дырки -> теряет адаптер или приложение
// Без этого счётчика обе выглядят одинаково, и лечить будешь не то.
uint16_t telDrop = 0;

// Обе величины определены НИЖЕ по файлу, а нужны в обработчике выше.
extern uint16_t u220_kod; // myADC.c: сырой отсчёт канала U220, 0..4095
extern float    phaseErr; // 1ph_Sin.c: ошибка фазы в единицах sin()

#if DBG_SIN_DAC
//--------------------------------------------------------------------------------------
// dbg  Настройка ЦАП CMPSS1 (COMPDACL) на вывод в пин A1, B7, D11, CMP1_DACL.
// На F28P55x нет DACB, но нижний ЦАП CMPSS1 можно перевести в режим
// ЦАП общего назначения (11 бит, 0..2047) с выводом на внешний пин.
// ВНИМАНИЕ: при этом весь модуль CMPSS1 (оба компаратора, верхний ЦАП,
// генератор рампы и цифровые фильтры) становится недоступен - защита по току
// фазы А через CMPSS1 не работает.
//--------------------------------------------------------------------------------------
void dacb_CMPSS1_init(void)
{
    SysCtl_enablePeripheral(SYSCTL_PERIPH_CLK_CMPSS1);
    CMPSS_enableModule(CMPSS1_BASE); // COMPDACE - включение питания ЦАП

    // значение из DACLVALS переписывается в активный регистр по SYSCLK,
    // т.е. запись действует сразу, а не по PWMSYNC
    CMPSS_configDACLow(CMPSS1_BASE, CMPSS_DACVAL_SYSCLK | CMPSS_DACSRC_SHDW);
    CMPSS_setDACValueLow(CMPSS1_BASE, 1024); // середина 11-битной шкалы

    ASysCtl_enableCMPSSExternalDAC(ASYSCTL_CMPSS1_DACL); // вывод COMPDACL на пин
}
#endif // DBG_SIN_DAC

float    sine1 = 0;
volatile uint16_t epwmcount = 0;// dbg счётчик для измерения периода прерываний
volatile uint16_t epwmtime = 0;// dbg период прерываний

// Синхронизация по амплитуде живёт не здесь, а в u220_sample() (my_Files/myADC.c):
// вилка u220hi_kod/u220low_kod ловит размах U220, sineB.gain идёт за ней. Прежний
// вариант через ampSync (gain = 2048 * U220ампл / Vin) удалён - два регулятора дрались
// бы за sineB.gain, а Vin на стенде всё равно не подключён.

//--------------------------------------------------------------------------------------
// ТАКТ УПРАВЛЕНИЯ - ЕДИНСТВЕННОЕ ПРЕРЫВАНИЕ АЦП НА ВСЮ РАБОТУ.
//
// Живёт на ADCB INT1 (EOC1 - конец преобразования Ib), хотя запускает ADCB
// по-прежнему EPWM1 SOCA по TBCTR = PRD.
//
// Почему не по прерыванию EPWM1, как было раньше. SOCA и прерывание EPWM1
// срабатывают в ОДИН и тот же момент, поэтому в начале прежнего обработчика в
// ADCB лежал отсчёт ПРОШЛОГО периода: преобразование текущего только начиналось.
// Плюс полтакта на загрузку теневого CMPA по TBCTR = 0 - итого 1.5 такта, 300 мкс.
//
// Здесь мы стартуем примерно через 2.4 мкс после TBCTR = PRD, когда Ia и Ib уже
// преобразованы. Задержка контура становится 0.5 такта, 100 мкс - остаётся одна
// теневая загрузка CMPA, а её убирать нельзя, на ней держится симметрия ШИМ.
// На 300 Гц это снимает с контура около 21 градуса фазового запаздывания.
//
// ПОРЯДОК РАБОТЫ ТАКТА, сверху вниз - он же порядок строк:
//
//     u220_sample()      канал сети и вилка огибающей (ADCA SOC0, готов к 1.2 мкс)
//     токи              с АЦП либо из модели, но никогда не оба сразу
//     grid_tie_measure() uGrid и Udc
//     plant_sim_step()   модель отрабатывает ПРОШЛЫЙ такт моста
//     контур            grid_tie_step() либо sine_invertor2()
//     телеметрия        быстрый кадр в шину
//     CLA_forceTasks()   действующие значения и мощности - задаче CLA
//
// ДВУХ ПРЕРЫВАНИЙ АЦП БОЛЬШЕ НЕТ (23.09.2026). Канал сети читало отдельное
// прерывание ADCA INT1 по EOC0, и нужды в этом не было ни дня: результат
// преобразования лежит в регистре до следующего такта, прочитать его на
// микросекунду позже ничего не стоит. Ушли второй вектор, второй ACK группы
// PIE и необходимость помнить, кто из них в PIE старше.
//
// ЗАДАЧУ CLA ТЕПЕРЬ ЗАПУСКАЕМ САМИ, последней строкой. Раньше её взводил
// EOC3 модуля ADCA - то есть середина этого обработчика, и задача читала
// переменные, которые он в этот момент ещё дописывал. Гонка была настоящей и
// стоила одного разбора (см. plant_sim.txt, 4.4). Теперь CLA стартует, когда
// писать уже нечего, и сам класс ошибки исчез.
//--------------------------------------------------------------------------------------
#pragma CODE_SECTION(INT_myADCB_1_ISR, ".TI.ramfunc");

__interrupt void INT_myADCB_1_ISR(void)
{
    tim0S = EPwm7Regs.TBCTR;
    epwmcount++;

    // Флаг EOC3 модуля ADCA сбрасываем на входе, а смотрим в конце такта: он
    // и есть признак того, что три "поздних" канала успели преобразоваться.
    // Подробности - у места проверки.
    ADC_clearInterruptStatus(myADCA_BASE, ADC_INT_NUMBER2);

    // Канал сети и вилка огибающей. Было отдельным прерыванием ADCA INT1,
    // стало первой строкой такта - разбор у определения в myADC.c.
    u220_sample();

    // Токи обмоток: с АЦП либо из модели, но НИКОГДА ОБА СРАЗУ. Двойная запись
    // в одну переменную за такт уже стоила одного разбора: задача CLA успевала
    // заглянуть между ними и забрать отсчёт плавающего входа (plant_sim.txt,
    // 4.4). Теперь CLA запускается в конце такта и такого окна нет вовсе, но
    // правило "один хозяин на переменную" остаётся - оно того же рода, что и
    // порядок строк ниже.
    if (!sim.on)
        xfmr_currents_from_adc();

    // Измерения тракта (uGrid, Udc) и такт модели - до такта управления и в
    // обоих режимах моста.
    //
    // Порядок не переставлять. Модель обязана отработать тот индекс модуляции,
    // что реально стоял в компараторах последний период; посчитай её после
    // контура - и она окажется на такт быстрее реальности, показав
    // устойчивость, которой на железе не будет. А ЭДС сети ей нужна текущего
    // такта, отсюда и grid_tie_measure() впереди. Разбор - plant_sim.txt.
    //
    // Когда модель выключена (sim.on = 0), plant_sim_step() выходит сразу и
    // токи остаются теми, что прочитаны с АЦП строкой выше.
    grid_tie_measure();
    plant_sim_step();

    if (gridMode)
    {
        // Сетевой режим: мост работает источником тока, CMPA считает замкнутый
        // контур. grid_tie_step() двигает sineB.angle сам - иначе встал бы PLL.
        grid_tie_step();
    }
    else
    {
        // Метод один. Ветка по sine_metod убрана вместе с sine_invertor1.
        // Поправку постоянки sine_invertor2() берёт готовой из mDC: контур
        // считает CLA, в обоих режимах одинаково, вызывать здесь нечего.
        sine_invertor2(&sineB);
    }

    // RMS здесь больше не считается - его взяла на себя CLA, Cla1Task1.
    // С 24.09.2026 там же и весь контур подавления постоянной составляющей:
    // CPU только применяет готовый mDC к компараторам.
    //---------------------------------------------------------------------
    // DBG  daca -это синусоидальный сигнал, который выводится на вход АЦП для иммитации сигнала u220

    // daca = (0.5f * sinf(sine_angle +sineA) + 0.5f) *sineA.gain; // u220
    //  dacb = (0.5f * sinf(sine_angle + sine0 + sine1) + 0.5f) *sineB.gain;// pwm sinus

    // DAC_setShadowValue(myDAC1_BASE, dacb); //  A1, B7, DACB_OUT HSEC pin 11
    //---------------------------------------------------------------------
#if Strob_rg
    if (sineB.angle >= rgStrob)
        if (angleOld < rgStrob)
        {
            index = 0;
        }
    angleOld = sineB.angle;

    if (index == strobIndex)
    {
        GpioDataRegs.GPBTOGGLE.bit.GPIO32 = 1;
    }
#endif // Strob_rg

    index++;
    sineTick++;

// dacb нужен всегда: по нему в INT_U220_zero_ECAP_ISR и adjustPhaze() идёт подстройка фазы
    // offset обязателен: sine_invertor1/2 модулируют ШИМ как sinf(angle + offset),
    // и детектор фазы должен мерить именно тот сигнал, который реально идёт в мост.
    float b = sinf(sineB.angle + sineB.offset) * sineB.gain + 2048; // pwm sinus
    b       = (b < 0) ? 0 : b;
    dacb    = (b > 4095) ? 4095 : b;
#if DBG_SIN_DAC
    // dbg вывод на пин A1, B7, D11, CMP1_DACL. Что именно - см. dacDbgSrc.
    //
    // ЦАП здесь 12-битный, шкала 0..4095: драйверлиб проверяет value < 4096.
    // Прежний комментарий про "11 бит, поэтому >> 1" был ошибкой - сдвига в коде
    // никогда и не было, так что вывод всё это время работал правильно.
    {
        float d;
        switch (dacDbgSrc)
        {
            case 1:  d = 2048.0f + kDacDbg * iPri_amp;  break; // ток первички, А
            case 2:  d = 2048.0f + kDacDbg * iSec_amp;  break; // ток вторички, А
            case 3:  d = 2048.0f + kDacDbg * gt.m;      break; // индекс модуляции
            case 4:  d = 2048.0f + kDacDbg * gt.iref;   break; // заданный ток, А
            case 5:  d = 2048.0f + kDacDbg * gt.ierr;   break; // ошибка тока, А
            case 6:  d = 2048.0f + kDacDbg * gt.uSec;   break; // требуемое U втор., В
            case 7:  d = 2048.0f + kDacDbg * gt.uGrid;  break; // U сети (вторичка), В
            case 8:  d = 2048.0f + kDacDbg * mDC;    break; // поправка пост. сост.
            case 9:  d = 2048.0f + kDacDbg * u220_volt; break; // измеренное U сети, В
            case 10: d = 2048.0f + kDacDbg * phaseErr;  break; // ошибка фазы
            case 11: d = 2048.0f + kDacDbg * iBat_amp;  break; // ток АКБ, А
            default: d = (float)dacb;                    break; // синусоида ШИМ, как было
        }
        d      = (d < 0.0f) ? 0.0f : ((d > 4095.0f) ? 4095.0f : d);
        dacDbg = (uint16_t)d;
        CMPSS_setDACValueLow(CMPSS1_BASE, dacDbg);
    }
#endif
// -------------------------------------------------------------------------------
    // Угол уже увеличен на step внутри sine_invertor1()/sine_invertor2().
    // Повторное приращение здесь давало 2*step за прерывание -> выход шёл на 100 Гц
    // и подстройка фазы не успевала за дрожанием (2*step = 0.126 рад против шага 0.01).
    // sineB.angle = PI2sut(sineB.angle + sineB.step);

    // Флаг ADCINT1 снимаем вручную, хотя у канала включён continuous mode и без
    // этого следующее прерывание всё равно придёт. Иначе флаг стоял бы всегда и
    // по нему нельзя было бы отличить рабочий такт от зависшего.
    ADC_clearInterruptStatus(myADCB_BASE, ADC_INT_NUMBER1);
    Interrupt_clearACKGroup(INTERRUPT_ACK_GROUP1);

    //-----------------------------------------------------------------
    // Три "поздних" канала - ток и напряжение АКБ, напряжение на выходе
    // инвертора. Читаются ЗДЕСЬ, перед телеметрией и запуском задачи CLA,
    // потому что только к этому месту такта они преобразованы.
    //
    // Флаг ADCA INT2 взведён по EOC3 и сброшен нами на входе в обработчик -
    // значит поднят он ровно тем преобразованием, которое идёт сейчас. Не
    // поднят - обработчик обогнал АЦП (такое возможно, если код соберут с
    // оптимизацией и такт ужмётся до двух микросекунд), и в регистрах ещё
    // прошлый отсчёт. Величины всё равно берём - прошлый отсчёт лучше
    // пропуска, - но факт считаем: adcLate растёт, значит пора смотреть
    // sine_Time и порядок строк.
    if (!ADC_getInterruptStatus(myADCA_BASE, ADC_INT_NUMBER2))
        adcLate++; // dbg

    if (!sim.on)
        adc_late_sample();

   uint32_t txbrp = HWREG_BP(MCANA_DRIVER_BASE + MCAN_TXBRP);

   // Оба кадра живут в одном буфере, поэтому проверка занятости у них общая.
   // Буфер занят - пропускаем такт: разрывы видны по счётчику тактов в самом
   // кадре (последнее слово у F3, слово 3 у F1) и считаются в telDrop.
   //
   // Отдельной проверки "включён ли хоть один кадр" здесь тоже нет - её роль
   // играет сама цепочка. Так убран целый класс ошибки: длина стоит литералом
   // там же, где собран кадр, и состояния "отправляем, но неизвестно сколько"
   // не существует. В прежней редакции длина жила в переменной, заполняемой
   // в ветках, а от отправки при обоих выключенных битах спасала только
   // внешняя проверка - стоило её снять, и в Send_mbox_FD уходил мусор со
   // стека.
   if ((txbrp & MCAN_TXBRP_TRP1) == 0U) // TRP1  проверяет Buff = 1  !!! Buff = 0,1,2,....32
   {
       if (canaKadr.bit.F3_convertor == 1)
       {
           // Раскладка и масштабы - в таблице выше. Порядок менять нельзя,
           // приёмная сторона читает по номеру слова: прошивка, разбор в
           // Kadr60.cs (ProcessFrame103) и настройки каналов Wscope
           // (bin/Wscope/F3_convertor.ini) должны совпадать все трое.
           uint16_t f[16];
           uint16_t tbprd = EPwm1Regs.TBPRD;

           // Коэффициент трансформации для расчёта тока намагничивания ниже.
           // Берётся тот, которым пользуется КОНТУР: на железе другого и нет,
           // а на модели расхождение sim.n с gt.n - отдельный опыт, и пусть
           // оно в этом канале честно проявится.
           float nInv = (gt.n > 0.1f) ? (1.0f / gt.n) : 0.0f;

           f[0] = (int16_t)(10000.0f * phaseErr); // 1e-4
           f[1] = (int16_t)(10.0f * gt.uGrid);   // 0.1 В
           f[2] = (int16_t)(100.0f * gt.iref);   // 0.01 А
           f[3] = (int16_t)(100.0f * iSec_amp); // 0.01 А
           f[4] = (int16_t)(100.0f * iPri_amp); // 0.01 А
           f[5] = (int16_t)(10000.0f * gt.m);    // 1e-4
           f[6] = (int16_t)(10000.0f * (1.0f - (float)cmpaA / (float)tbprd));
           // Напряжение звена - ИЗМЕРЕННОЕ, с датчика (канал uBat, A4).
           //
           // Здесь стояло gt.Udc, и это была ошибка: gt.Udc - не измерение, а
           // то, ЧЕМ КОНТУР ДЕЛИТ, и при UdcSrc = 0 туда подставляется
           // константа UdcFixed. В ленту ехала бы прямая линия вместо сигнала.
           // Канал же преобразуется каждый такт независимо ни от чего.
           f[7] = (int16_t)(10.0f * uBat_volt);    // 0.1 В
           f[8] = (int16_t)(100000.0f * mDC);   // 1e-5
           f[9] = dacb;                            // коды, 0..4095

           // Дописано 23.09.2026: в кадре не было ни одного напряжения, кроме
           // сетевого, и ни одного тока, кроме обмоточных.
           f[10] = (int16_t)(10.0f * uSec_volt);  // 0.1 В  выход инвертора
           f[11] = (int16_t)(100.0f * iBat_amp);  // 0.01 А ток АКБ

           // Ток намагничивания, приведённый ко вторичке. Не измеряется
           // датчиком - его и не существует отдельно, - а считается из двух
           // измеренных токов: iПерв/n - iВтор. На модели это в точности
           // sim.iMag, на железе - настоящий ток намагничивания, и именно по
           // нему видно уход потока в сердечник (grid_tie.txt, 3.1).
           f[12] = (int16_t)(100.0f * (iPri_amp * nInv - iSec_amp)); // 0.01 А

           // Мгновенная мощность на выходе инвертора, ватты.
           //
           // Произведение тех же двух каналов, из которых CLA считает
           // активную: усредни эту кривую за период сети - и получишь ровно
           // pSec, то самое число, что стоит в окне и в слове 17 кадра 140.
           // Отсюда и польза ленты: видно не только сколько, но и КАК.
           //
           // Пульсация двойной частоты здесь не артефакт, а физика однофазного
           // моста: произведение двух синусоид одной частоты даёт постоянную
           // часть плюс колебание на 100 Гц с размахом от нуля до двойного
           // среднего. Именно её мост тянет из АКБ, и именно ради неё gt.Udc
           // берётся мгновенным (grid_tie.txt, 3.3).
           //
           // Единица - ватт: при 3 кВт мгновенная доходит до 6 кВт, а с
           // реактивной нагрузкой уходит и в минус. Десятые доли в int16 не
           // влезли бы, а ограничение ставится явно - в модели ничто не мешает
           // задать нагрузку в доли ома.
           {
               float p = uSec_volt * iSec_amp;

               p = (p > 32767.0f) ? 32767.0f : ((p < -32767.0f) ? -32767.0f : p);

               f[13] = (int16_t)p;
           }

           // Резерв под будущее. Уходит нулём и стоит ПЕРЕД счётчиком - так же,
           // как резерв в кадре 140.
           //
           // Два слова освободились 23.09.2026: ушли u220_kod (сырые коды того
           // же канала, что уже едет вольтами в слове 1) и измеренное
           // напряжение АКБ (то же самое, что Vin в слове 7, - на железе это
           // один канал, а на стенде и то и другое константа). Одно тут же
           // заняла мгновенная мощность, второе ждёт.
           f[14] = 0;

           // Счётчик тактов ОБЯЗАН быть последним словом кадра. Motor_Control
           // считает запись готовой по ИЗМЕНЕНИЮ последнего слова
           // (CanaAsync.cs: if (_cntRef == ccs.k60Cnt) return), и величина,
           // способная повториться у соседних отсчётов, на этом месте
           // заставит запись стоять. Он же показывает пропуски кадров:
           // Send_mbox_FD молча пропускает такт, если буфер занят.
           f[15] = sineTick;

           Send_mbox_FD(1, f, 16); // 32 байта, DLC = 13
       }
       else if (canaKadr.bit.F1_convertor == 1)
       {
           uint16_t f[4];

           switch (telSrc)
           {
               case 1:                                   // контур тока: ierr считается в Wscope как f0 - f1
                   f[0] = (int16_t)(100.0f * gt.iref);   // 0.01 А
                   f[1] = (int16_t)(100.0f * iSec_amp); // 0.01 А
                   f[2] = (int16_t)(10000.0f * gt.m);    // 1e-4
                   break;

               case 2:                                   // трансформатор и постоянная составляющая
                   f[0] = (int16_t)(100.0f * iPri_amp); // 0.01 А
                   f[1] = (int16_t)(10.0f * gt.uGrid);   // 0.1 В, с запасом
                                                         // на перетарировку kU220
                   f[2] = (int16_t)(100000.0f * mDC); // 1e-5, |mDC| < 0.02
                   break;

               case 3:                                    // синхронизация: обе опоры детектора фазы и его ошибка
                   f[0] = dacb;                           // коды, 0..4095
                   f[1] = u220_kod;                       // коды, 0..4095
                   f[2] = (int16_t)(10000.0f * phaseErr); // 1e-4
                   break;

               default: // как было
                   f[0] = cmpaA;
                   f[1] = cmpaB;
                   f[2] = (int16_t)(duty * 1000);
                   break;
           }

           f[3] = sineTick; // счётчик тактов: по разрывам видны пропуски кадров

           Send_mbox_FD(1, f, 4); // 8 байт, DLC = 8
       }
   }
   else if (canaKadr.bit.F3_convertor || canaKadr.bit.F1_convertor ||
            canaKadr.bit.F3_invertor || canaKadr.bit.F1_invertor)
   {
       // Буфер ещё занят прошлым кадром - этот такт в ленту не попадёт.
       //
       // Счётчик был заведён 20.08.2026 и до 23.09.2026 никем не
       // увеличивался: строки, которая это делает, в коде не было. То есть
       // записанное тогда "telDrop = 0, пропусков нет" не значило ничего -
       // переменная просто лежала в нуле с момента загрузки. Теперь считает.
       //
       // Нужен он затем, что пропуск на шине и потеря в приложении выглядят
       // в ленте одинаково, а лечатся по-разному:
       //   telDrop растёт  -> не успевает шина или буфер (кадр велик, telDiv)
       //   telDrop = 0     -> теряет адаптер или Motor_Control
       telDrop++;
   }

    //-----------------------------------------------------------------
    // И только теперь - задаче CLA. Действующие значения и мощности она
    // считает по величинам, которые обработчик уже дописал ВСЕ, включая три
    // поздних канала выше.
    //
    // До 23.09.2026 задачу взводил EOC3 модуля ADCA - то есть середина этого
    // обработчика. Она читала переменные, которые он в этот момент ещё писал,
    // и один такой случай стоил разбора (plant_sim.txt, 4.4). Программный
    // запуск в конце такта убирает не конкретную гонку, а саму возможность
    // такой гонки: писать больше нечего.
    //
    // Задача уйдёт работать параллельно фоновому циклу и успеет закончить
    // задолго до следующего такта: её длительность task1Time около 1.1 мкс
    // против 200 мкс периода.
    CLA_forceTasks(myCLA0_BASE, CLA_TASKFLAG_1);


    sine_Time = EPwm7Regs.TBCTR - tim0S; // dbg монитор времени выполнения программы
}
//--------------------------------------------------------------------------------------
// Заглушка INT_myEPWM1_ISR удалена 20.08.2026. Прерывание EPWM1 больше не несёт
// работы - весь такт управления переехал в INT_myADCB_1_ISR, - а галка
// "Enable Interrupt" у myEPWM1 снята в SysConfig, так что вектор в board.c
// не регистрируется и ссылаться на функцию стало некому.
__interrupt void INT_myEPWM1_TZ_ISR(void) {}

extern uint16_t u220_kod; // myADC.c: текущий отсчёт АЦП канала U220 (A0), 0..4095

float    zstep = 0.01;
uint16_t u220_Time; // период сетевого напряжения
uint16_t u220tim0;  // значение счётчика таймера при предыдущем пересечении нуля
float    u220freq;
uint16_t tbperEPWM1; // time base piriod for EPWM1
float    angleA, angleB;
uint32_t u220_badCapture; // dbg счётчик отбракованных захватов (32 бита - 16 переполнялся за секунды)

// Коэффициенты контура подстройки фазы. Вынесены в переменные, чтобы крутить
// их в отладчике на живой цели, не пересобирая проект.
float phaseK    = 0.25f; // коэффициент пропорциональной коррекции
float phaseMax  = 0.05f; // максимальная коррекция за период сети, рад (0.05 -> PI за ~1.3 с)
float phaseErr;          // dbg текущая ошибка фазы
float phaseCorr;         // dbg применённая коррекция

// Сглаживание измеренного периода сети. Частота сети стабильна, а вот момент
// захвата дрожит, и без фильтра TBPRD переписывается каждый период. Разброс
// u220_Time всего в 2% даёт уход фазы 0.126 рад за период - контур с ограничением
// phaseMax = 0.05 такое догнать не может.
float u220_TimeK = 0.1f; // постоянная IIR: 0.1 -> ~10 периодов сети на установление
float u220_TimeF;        // сглаженный период сети, такты TBCLK8

// Окно допустимого периода сети в тактах TBCLK8 (1 171 875 Гц):
// 14000 -> 84 Гц, 35000 -> 33 Гц. Всё, что вне окна - ложный захват.
#define U220_TIME_MIN 14000U
#define U220_TIME_MAX 35000U

//Эта программа прерывания запускается напрямую от CMPSS3 (верхний компаратор, переход U220 через ноль):
//CMPSS3.CTRIPH заведён во вход захвата eCAP1 (U220_zero_ECAP) по внутренней шине, без GPIO и без X-BAR.

__interrupt void INT_U220_zero_ECAP_ISR(void)
{
    ECAP_clearInterrupt(U220_zero_ECAP_BASE, ECAP_ISR_SOURCE_CAPTURE_EVENT_1);

    u220_Time       = EPwm8Regs.TBCTR - u220tim0; //  монитор времени выполнения программы
    u220tim0        = EPwm8Regs.TBCTR;
    // EPWM8: EPWMCLK = SYSCLK = 150 МГц (на F28P55x делителя EPWMCLKDIV нет),
    // CLKDIV=64 * HSPCLKDIV=2 -> /128 -> TBCLK8 = 1 171 875 Гц.
    // (на F280039C было 60 МГц / 32 = 1 875 000 Гц - отсюда старая константа)
    // Ложный захват (дребезг компаратора, первый захват после старта с u220tim0 = 0)
    // НЕЛЬЗЯ пускать в TBPRD: при u220_Time = 94 получается TBPRD = 30, период EPWM1
    // падает до 0.8 мкс, ISR EPWM1 (INT3.1) занимает CPU целиком и вытесняет
    // ISR EPWM6 (INT3.6) в той же группе PIE. daca замирает, CTRIPH залипает в 1,
    // захваты прекращаются - и починить TBPRD уже некому.
    if ((u220_Time >= U220_TIME_MIN) && (u220_Time <= U220_TIME_MAX))
    {
        // IIR по периоду сети. Первый достоверный захват загружаем как есть,
        // иначе фильтр будет долго выползать из нуля.
        if (u220_TimeF < (float)U220_TIME_MIN)
            u220_TimeF = (float)u220_Time;
        else
            u220_TimeF += u220_TimeK * ((float)u220_Time - u220_TimeF);

        u220freq        = 1171875.0f / u220_TimeF;
        // TBCLK1 = 150 МГц / 2 (HSPCLKDIV=2 по сбросу, CLKDIV=1) = 75 МГц -> TBCLK1/TBCLK8 = 64.
        // EPWM1 в режиме UP_DOWN, поэтому TBPRD = полпериода: 64/2 = 32.
        tbperEPWM1      = (u220_TimeF * 32.0f) / sineB.resolution;

        // Ошибка фазы = разница мгновенных значений опоры и нашей синусоиды в момент
        // захвата. Сравниваем значения, а не углы: тогда точка срабатывания компаратора
        // (из-за DAC_GAIN_TWO она не совпадает с нулём daca) выпадает из уравнения.
        angleB = dacb;
        // gt.refSrc = 0 - опора daca, синусоида от ЦАП (стенд).
        // gt.refSrc = 1 - опора u220_kod, реально измеренная сеть.
        // Обе величины в одной шкале 0..4095, поэтому нормировка phaseErr не меняется.
        angleA    = (gt.refSrc) ? (float)u220_kod : (float)daca;
        phaseErr  = (angleB - angleA) / sineB.gain; // в единицах sin(), знак = опережение
        phaseCorr = phaseK * phaseErr;
        // Ограничение скорости: один ложный захват не должен дёрнуть фазу рывком.
        if (phaseCorr > phaseMax)
            phaseCorr = phaseMax;
        else if (phaseCorr < -phaseMax)
            phaseCorr = -phaseMax;

        //-----------------------------------------------------------------
        // Здесь проходит граница между ИЗМЕРЕНИЕМ сети и ВЕДЕНИЕМ за ней.
        //
        // Всё, что выше, считается всегда: u220freq, phaseErr и вилка огибающей
        // - это приборы, по ним оператор и судит о сети. Всё, что ниже, правит
        // нашу синусоиду, и делать это без слежения нельзя.
        //
        // Раньше эти три строки выполнялись безусловно, и "независимого
        // источника" не существовало в принципе: TBPRD и step переписывались по
        // каждому захвату, то есть частота моста всегда шла за частотой сети
        // (а на стенде - за сигналом daca), что бы ни стояло в sineB.freq.
        // Теперь при выключенном слежении период остаётся тем, который задали
        // командой 624 через change_sine().
        //-----------------------------------------------------------------
        if (gridMode)
        {
            EPwm1Regs.TBPRD = sineB.pwm_period = tbperEPWM1;

            // Целочисленный TBPRD не может выразить дробную часть периода (при 50 Гц идеал
            // 7500.75, в регистр уходит 7500). Остаток расстройки забираем в шаг угла:
            // step = 2*PI * Tшим / Tсети, обе величины в тактах TBCLK8.
            // Период ШИМ в тактах TBCLK8 = TBPRD/32 (UP_DOWN даёт 2*TBPRD тактов TBCLK1,
            // а TBCLK1/TBCLK8 = 64). Берём именно tbperEPWM1 - то целое, что реально в TBPRD.
            // Без этой строки offset вынужден непрерывно ползти со скоростью 0.03 рад/с,
            // компенсируя уход частоты 1e-4.
            sineB.step = PI2 * ((float)tbperEPWM1 / 32.0f) / u220_TimeF;

            sineB.offset = asut(sineB.offset - phaseCorr);
            // sineB.angle НЕ трогаем: угол должен идти непрерывно, иначе каждый захват
            // даёт разрыв в форме сигнала. Фазу двигает только offset.

            // Всё медленное сетевого режима - автомат, нарастание уставки тока,
            // контур подавления постоянной составляющей, сторож пропажи сети -
            // живёт здесь, раз за период сети. Только по достоверному захвату:
            // ложный не должен ни продвигать автомат, ни перезаряжать сторож.
            //
            // Строго ПОСЛЕ правок выше: grid_tie_onGridZero() пересчитывает Ts
            // по свежему TBPRD и сажает резонатор PR на свежий sineB.step.
            grid_tie_onGridZero();
        }
    }
    else
    {
        u220_badCapture++; // dbg
    }

    // Сжатие вилки U220 (u220hi_kod--/u220low_kod++) переехало в u220_sample():
    // здесь оно шло раз за период сети против 100 раздвижек за тот же период, и вилка
    // почти не сжималась. Скорость сжатия - u220spadDiv в myADC.c.

    // Без сброса глобального флага ECCLR.INT модуль eCAP больше не выдаёт
    // прерываний - ISR отрабатывает ровно один раз после прошивки.
    ECAP_clearGlobalInterrupt(U220_zero_ECAP_BASE);
    ECAP_reArm(U220_zero_ECAP_BASE);
    Interrupt_clearACKGroup(INTERRUPT_ACK_GROUP4);
}

__interrupt void U220_ADCC_ZERO(void)
{
    //adjustPhaze();
    // PieCtrlRegs.PIEACK.all = PIEACK_GROUP10;
    Interrupt_clearACKGroup(INTERRUPT_ACK_GROUP10);
}

void adjustPhaze(void)
{
    if (GpioDataRegs.GPASET.bit.GPIO26)
    {
        GpioDataRegs.GPBSET.bit.GPIO32 = 1;
        if (dacb > 2048)
            sine0 = sine0 + zstep;
        else
            sine0 = sine0 - zstep;
        Cmpss3Regs.COMPSTSCLR.bit.HLATCHCLR = 1;
    }
    else
    {
        GpioDataRegs.GPBCLEAR.bit.GPIO32    = 1;
        Cmpss3Regs.COMPSTSCLR.bit.HLATCHCLR = 1;
        if (dacb < 2048)
            sine0 = sine0 + zstep;
        else
            sine0 = sine0 - zstep;
    }
    // DEVICE_DELAY_US(50);
}
// ------------------------------------------------------------------------
// DBG

__interrupt void INT_myEPWM6_ISR(void)
{
      GpioDataRegs.GPBTOGGLE.bit.GPIO57 = 1; // scope dbg
    sineA.angle = PI2sut(sineA.angle + sineA.step);
    float a     = sinf(sineA.angle + sineA.offset) * sineA.gain + 2048; // u220
    a           = (a < 0) ? 0 : a;
    daca        = (a > 4095) ? 4095 : a;
    DAC_setShadowValue(myDAC1_BASE, daca); // A0, B15, C15 ,DACA_OUT -> HSEC pin 9

    EPwm6Regs.ETCLR.bit.INT = 1;
    Interrupt_clearACKGroup(INTERRUPT_ACK_GROUP3);
}

void change_sine(struct sine *s)
{
    s->step       = PI2 / s->resolution;
    s->tpwm_sek   = (1.0f / s->freq) / s->resolution; // pwm period  в секундах
    // TBPRD в тактах TBCLK. TBCLK1 = TBCLK6 = 150 МГц / 2 (HSPCLKDIV = 2 по
    // сбросу, CLKDIV = 1) = 75 МГц.
    //
    // Делитель зависит от РЕЖИМА СЧЁТА, а не только от частоты. EPWM1 (sineB)
    // идёт UP_DOWN: за период счётчик проходит TBPRD вверх и столько же вниз,
    // значит в TBPRD кладётся полпериода - 37.5e6 вместо 75e6. EPWM6 (sineA)
    // считает только вверх, там делить нечего.
    //
    // Прежде здесь стояло 75e6 для обоих, и у моста выходная частота выходила
    // ВДВОЕ НИЖЕ заданной: при sineB.freq = 60 на пине было 30 Гц. В АИН это
    // ничем не компенсировалось. В слежении за сетью не всплывало: там TBPRD
    // переписывает захват eCAP (tbperEPWM1 выше по файлу), и он-то полпериода
    // учитывает. Те же полпериода учитывает и gt.Ts в grid_tie.c.
    s->pwm_period = s->tpwm_sek * (s->upDown ? 37.5e6f : 75e6f);

    // Окно усреднения RMS для CLA. Копия нужна потому, что sineB лежит в
    // обычной .data (RAMLS5/6), а CLA видит только отданные ей блоки - LS1,
    // LS2, LS7 - и message RAM; прочитать sineB.resolution она не может.
    //
    // Место выбрано не случайно: change_sine() - единственный путь, которым
    // resolution вообще меняется (команды CAN 621/622/62x в MBOX28.c и
    // инициализация в main.c). Пока копия обновляется здесь, разъехаться с
    // оригиналом она не может.
    if (s == &sineB)
    {
        rmsWindow = s->resolution;
    }
}
