/*
 * power_par.c
 *
 * Паспорт силовой части: заводские значения и раздача по потребителям.
 * Смысл, правила изменения и порядок ввода на новой машине - в power_par.h
 * и my_Files/power_par.txt.
 */

#include <stdint.h>
#include <math.h>

#include "power_par.h"
#include "KSP.h"         // motors[] - признак "ключи открыты"
#include "grid_tie.h"
#include "plant_sim.h"
#include "cla_shared.h"
#include "calib_store.h" // calibSaveReq, calib_store_after_reset()

PowerPar pwr;
RegPar   reg;

float mNom;
float mLoad;

//---------------------------------------------------------------------------
// ЗАВОДСКИЕ ЗНАЧЕНИЯ - тот самый стенд, что был зашит литералами в
// grid_tie_init() и plant_sim_init() до 25.09.2026. Числа перенесены как есть,
// чтобы прибор без сохранённого паспорта вёл себя ровно как прежде и опыты из
// grid_tie.txt повторялись числом в число.
//
// Lmag = 1.4 Гн - порядок для трансформатора 3 кВт 220 В: ток намагничивания
// около 0.5 А действующего, то есть 1.5 % от номинала. Уточнять незачем, пока
// не появится настоящий сердечник.
//
// crc НАМЕРЕННО НОЛЬ. Это признак "паспорт не задавали", и он обязан
// сохраниться у заводских значений: иначе прибор навсегда начнёт выглядеть
// настроенным, ни разу им не побывав. На тех же граблях однажды постоял
// floatKadc() - разбор в myADC.c.
//---------------------------------------------------------------------------
PowerPar pwr_default = {
    .n      = 7.0f,
    .Lleak  = 0.008f,
    .Rwind  = 0.5f,
    .Lmag   = 1.4f,
    .Pnom   = 3000.0f,
    .UacNom = 220.0f,
    .UdcNom = 48.0f,
    .crc    = 0U,
};

//---------------------------------------------------------------------------
// Заводские коэффициенты регуляторов. Откуда они взялись - в grid_tie.txt:
// контур напряжения в разделе 11, подавление постоянки в 3.1.6.
//---------------------------------------------------------------------------
RegPar reg_default = {
    .uOutKp       = 0.3f,
    .uOutKi       = 0.1f,
    .uOutCorMax   = 60.0f,
    .uOutSatLimit = 50U,

    .kDC        = 0.0005f,
    .kDCp       = 0.005f,
    .mDCmax     = 0.02f,
    .dcSatLimit = 50U,

    .crc = 0U,
};

//---------------------------------------------------------------------------
// Сумма первых words слов. Границу задаёт вызывающий через offsetof до поля
// crc - почему именно так, разобрано в power_par.h.
//---------------------------------------------------------------------------
uint16_t power_sum(const void *p, uint16_t words)
{
    const uint16_t *w = (const uint16_t *)p;
    uint16_t        s = 0;
    uint16_t        i;

    for (i = 0; i < words; i++)
    {
        s = (uint16_t)(s + w[i]);
    }

    // Ноль означает "не задан", поэтому настоящая сумма нулём быть не должна:
    // иначе честно заполненный паспорт выглядел бы заводским. Случай редкий,
    // но бесплатный в обработке.
    return (s == 0U) ? 1U : s;
}

//---------------------------------------------------------------------------
// Какой паспорт в силе. Негодный - работаем на заводском. Проверка та же,
// что у калибровок АЦП: нулевая сумма означает "не задавали", несошедшаяся -
// "запись испорчена". В обоих случаях лучше заводское, чем мусор.
//---------------------------------------------------------------------------
static const PowerPar *pwr_active(void)
{
    return (pwr.crc != 0U) && (pwr.crc == POWER_SUM_PWR()) ? &pwr : &pwr_default;
}

//---------------------------------------------------------------------------
// Запас по индексу модуляции - ответ на "выйдет или нет" ДО включения.
//
//     mNom  на холостом ходу
//     mLoad при номинальной АКТИВНОЙ нагрузке
//
// Второе считается через делитель между импедансом обмотки и нагрузкой,
// по модулю комплексных сопротивлений:
//
//     Zнагр = Rload + j*0            активная
//     Zсум  = (Rwind + Rload) + j*w*Lleak
//     mLoad = mNom * |Zсум| / |Zнагр|
//
// Больше gt.mMax - уставка недостижима, и лечится это железом, а не
// коэффициентами (grid_tie.txt, 3.2). НА ИНДУКТИВНОЙ НАГРУЗКЕ ХУЖЕ,
// причём заметно: там падение на рассеянии коллинеарно реактивной части
// нагрузки и вычитается целиком, а не вторым порядком. Формула этого не
// ловит намеренно - она про активную; реактивную гоняют моделью (11.8).
//---------------------------------------------------------------------------
static void pwr_margin(const PowerPar *p, float n)
{
    float uac = (p->UacNom > 1.0f) ? p->UacNom : pwr_default.UacNom;
    float udc = (p->UdcNom > 1.0f) ? p->UdcNom : pwr_default.UdcNom;

    mNom = 1.41421356f * uac / (n * udc);

    {
        const float w  = 2.0f * 3.14159265f * 50.0f;
        float       rl = sim.Rload;
        float       rs = p->Rwind + rl;
        float       xs = w * p->Lleak;

        mLoad = (rl > 1e-3f) ? (mNom * sqrtf(rs * rs + xs * xs) / rl) : mNom;
    }
}

//---------------------------------------------------------------------------
// Раздача паспорта. Список потребителей и довод про расхождение - в power_par.h.
//---------------------------------------------------------------------------
void power_par_apply(void)
{
    const PowerPar *p = pwr_active();

    const RegPar *r = (reg.crc != 0U) && (reg.crc == POWER_SUM_REG())
                          ? &reg
                          : &reg_default;

    // Защита от нулей в знаменателях. Паспорт правят руками через CAN, и
    // пустое поле не должно превращать прибор в машину по производству NaN:
    // один NaN в gt.n за такт расходится по всем шести каналам.
    float n   = (p->n > 0.1f) ? p->n : pwr_default.n;
    float uac = (p->UacNom > 1.0f) ? p->UacNom : pwr_default.UacNom;
    float udc = (p->UdcNom > 1.0f) ? p->UdcNom : pwr_default.UdcNom;
    float pn  = (p->Pnom > 1.0f) ? p->Pnom : pwr_default.Pnom;

    //-----------------------------------------------------------------
    // 1. Трансформатор - и контуру, и модели.
    //
    // Одно число в два места, и развести их больше нельзя: с 08.10.2026
    // команды 649 и 675 пишут не gt.n и sim.n, а pwr.n, и попадают сюда.
    // Две копии остались только потому, что контур и модель читают каждый
    // свою структуру.
    //-----------------------------------------------------------------
    gt.n = n;

    sim.n     = n;
    sim.Lleak = p->Lleak;
    sim.Rwind = p->Rwind;
    sim.Lmag  = p->Lmag;

    //-----------------------------------------------------------------
    // 2. Звено и уставка.
    //
    // gt.UdcFixed - это опять же ПРЕДСТАВЛЕНИЕ контура (то, чем он делит при
    // UdcSrc = 0), а sim.Udc - настоящее напряжение АКБ в модели. Просевший
    // АКБ, о котором контур не знает, - отдельный опыт, командой 674.
    //-----------------------------------------------------------------
    gt.UdcFixed = udc;
    sim.Udc     = udc;

    // Начальное значение измеренного звена. Со следующего же такта его
    // перепишет grid_tie_measure(), но до первого такта контур чем-то делить
    // обязан, и ноль там означал бы m = 0 на весь первый период.
    gt.Udc = udc;

    uOutRef = uac;

    //-----------------------------------------------------------------
    // 3. ОТСЕЧКИ ПО ТОКУ ВЫВОДЯТСЯ, А НЕ ЗАДАЮТСЯ.
    //
    //     Iвтор.ампл = sqrt2 * Pnom / UacNom,  плюс 30 % запаса
    //     Iперв      = n * Iвтор
    //
    // Тридцать процентов - не круглое число с потолка, а та же цифра, что
    // стояла в grid_tie_init() комментарием "3 кВт -> 19.3 А пика, запас
    // 30 %". Запас нужен под ток намагничивания и переходные процессы;
    // подробнее про его роль - в cla_shared.h у dcSatCnt.
    //
    // Ради этого номиналы и лежат в паспорте: задал 5 кВт - пороги
    // пересчитались сами, и не осталось способа забыть их поправить.
    //-----------------------------------------------------------------
    gt.ImaxSec = 1.41421356f * pn / uac * 1.3f;
    gt.ImaxPri = n * gt.ImaxSec;

    //-----------------------------------------------------------------
    // 4. Номинальная нагрузка модели. Активная: R = U^2/P.
    //
    // Сам тип нагрузки НЕ трогаем - им распоряжается оператор строкой
    // "Нагрузка" в Модель.ini, и по умолчанию это холостой ход. Мы задаём
    // только НОМИНАЛ резистора, чтобы "включить номинальную нагрузку" было
    // одним щелчком, а не расчётом в уме.
    //-----------------------------------------------------------------
    sim.Rload = uac * uac / pn;

    //-----------------------------------------------------------------
    // 5. Коэффициенты регуляторов - в message RAM, откуда их берёт CLA.
    //-----------------------------------------------------------------
    uOutKp       = r->uOutKp;
    uOutKi       = r->uOutKi;
    uOutCorMax   = r->uOutCorMax;
    uOutSatLimit = r->uOutSatLimit;

    kDC        = r->kDC;
    kDCp       = r->kDCp;
    mDCmax     = r->mDCmax;
    dcSatLimit = r->dcSatLimit;

    //-----------------------------------------------------------------
    // 6. Запас по индексу модуляции - см. pwr_margin().
    //-----------------------------------------------------------------
    pwr_margin(p, n);
}

//---------------------------------------------------------------------------
// Раздача ОДНОГО ТРАНСФОРМАТОРА - n, Lleak, Rwind, Lmag и то, что из них
// выводится. Разбор - в power_par.h.
//---------------------------------------------------------------------------
void power_par_apply_xfmr(void)
{
    const PowerPar *p = pwr_active();
    float           n = (p->n > 0.1f) ? p->n : pwr_default.n;

    gt.n = n;

    sim.n     = n;
    sim.Lleak = p->Lleak;
    sim.Rwind = p->Rwind;
    sim.Lmag  = p->Lmag;

    // Отсечка первички - отсечка вторички, приведённая через n. Саму
    // отсечку вторички трансформатор не меняет, она из Pnom и UacNom.
    gt.ImaxPri = n * gt.ImaxSec;

    pwr_margin(p, n);
}

//---------------------------------------------------------------------------
// dbg Фоновая часть: правка паспорта из отладчика. Разбор - в power_par.h.
//---------------------------------------------------------------------------
volatile uint16_t pwrCmd = 0;

//---------------------------------------------------------------------------
// "Мост модулирует - настройку не трогаем". Разбор и доводы - в power_par.h.
//---------------------------------------------------------------------------
uint16_t power_par_busy(void)
{
    return motors[0]->flag.bit.pwm_On ? 1U : 0U;
}

//---------------------------------------------------------------------------
// "Правку паспорта из таблицы отклонить". Разбор - в power_par.h.
//---------------------------------------------------------------------------
uint16_t power_par_edit_locked(void)
{
    return (power_par_busy() && !sim.on) ? 1U : 0U;
}

void power_par_background(void)
{
    if (pwrCmd == 0U)
        return;

    // Мост работает - ЖДЁМ, не сбрасывая команду. Отработает сама, как только
    // ключи закроют; повторять нажатие не нужно. Состояние видно снаружи -
    // команда 698.
    if (power_par_busy())
    {
        calibSaveStatus = CALIB_BUSY;
        return;
    }

    if (pwrCmd == 1U)
    {
        // Оператор правил поля pwr руками в Watch - пометить их своей суммой
        // и раздать. Сумму ставим здесь, а не в apply: apply зовётся и при
        // старте, где помечать заводские значения нельзя (см. pwr_default).
        //
        // ВО ФЛЕШ НЕ ПИШЕМ. Это правка в ОЗУ, и она должна оставаться
        // отменяемой - разбор в power_par.h.
        pwr.crc = POWER_SUM_PWR();
        reg.crc = POWER_SUM_REG();
        power_par_apply();
    }
    else if (pwrCmd == 2U)
    {
        // Заводской ПАСПОРТ в ОЗУ. Нулевая сумма у заводской структуры - это и
        // есть признак "не настраивался", apply его увидит.
        //
        // Коэффициенты НЕ трогаем: это отдельная настройка, у неё своя команда
        // сброса (5). Флеш тоже не трогаем - сброс такая же правка, и пока её
        // не записали, прежняя настройка во флеше цела.
        pwr = pwr_default;
        power_par_apply();
    }
    else if (pwrCmd == 5U)
    {
        // Заводские КОЭФФИЦИЕНТЫ в ОЗУ, паспорт не трогаем. Пара к команде 2.
        reg = reg_default;
        power_par_apply();
    }
    else if (pwrCmd == 3U)
    {
        // Записать то, что в ОЗУ. Сами во флеш не лезем даже отсюда: запись
        // делает calib_store_background() по заявке, и вся ленивая
        // инициализация Flash API живёт там.
        //
        // Если сохранять нечего (все четыре суммы нулевые), calib_save()
        // вернёт CALIB_NOTCAL и ничего не напишет; а если настройку только что
        // сбросили в заводскую, банк надо стереть, иначе после перезапуска
        // сброс откатится. Ровно этот разбор уже сделан в
        // calib_store_after_reset() - пользуемся им, а не повторяем.
        calib_store_after_reset();
    }
    else if (pwrCmd == 4U)
    {
        // Откат: перечитать записанное и применить, отбросив правки в ОЗУ.
        //
        // calib_load() безопасна где угодно - она только читает память банка,
        // Flash API ей не нужен. При пустом или чужом содержимом она НЕ трогает
        // структуры, поэтому заводские подставляем сами: "во флеше ничего нет"
        // и означает "прибор не настраивался".
        if (calib_load() != CALIB_OK)
        {
            pwr = pwr_default;
            reg = reg_default;
        }

        power_par_apply();
    }

    pwrCmd = 0;
}
