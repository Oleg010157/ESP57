/*
 * grid_tie.c
 *
 *  Created on: 17.08.2026
 *      Author: Oleg Pavlovsky
 *
 *  Отдача мощности в сеть: токовый контур (grid-following).
 *
 *  Топология: АКБ 24..60 В -> H-мост (EPWM1 = плечо A, EPWM2 = плечо B)
 *  -> повышающий трансформатор 50 Гц 3 кВт -> сеть 220 В.
 *
 *  Синхронизация (частота, фаза, амплитуда) живёт не здесь, а в 1ph_Sin.c
 *  и myADC.c - см. my_Files/U220_sync.txt. Отсюда берётся только готовый
 *  угол сети theta = sineB.angle + sineB.offset.
 *
 *  Почему контур тока, а не напряжения: два источника напряжения, включённые
 *  параллельно, обмениваются током, равным их разности, делённой на импеданс.
 *  Управлять этим током нельзя - можно только надеяться. Источник тока задаёт
 *  ток явно, и мощность становится уставкой, а не следствием.
 *
 *  Подробное описание - my_Files/grid_tie.txt
 */

#include "board.h"
#include <math.h>
#include "F28P55x_Device.h"

#include "KSP.h"     // asut(), Errors.h, ErrorCodes.h
#include "myADC.h"     // kadcf - масштабы каналов АЦП
#include "cla_shared.h" // измеренные величины всех каналов АЦП
#include "1ph_Sin.h"   // sineB: угол сети от PLL
#include "plant_sim.h" // sim.on: модель вместо железа
#include "grid_tie.h"

//---------------------------------------------------------------------------
// Внешние связи
//---------------------------------------------------------------------------
extern uint16_t daca;        // 1ph_Sin.c: имитация U220 (стенд)
extern float    u220freq;    // 1ph_Sin.c: измеренная частота сети, Гц
extern float    phaseErr;    // 1ph_Sin.c: ошибка фазы в единицах sin()
// u220amp / u220_kod объявлены в cla_shared.h вместе с остальными каналами
extern uint16_t u220hi_kod;  // myADC.c:   верхняя губа вилки огибающей
extern uint16_t u220low_kod; // myADC.c:   нижняя губа вилки огибающей

extern void IGBT1_Disable(void);
extern void IGBT2_Disable(void);

struct GridTie gt;
uint16_t       gridMode = 0; // 0 = старый режим синусоиды, 1 = сетевой

// dbg Команда пуска/останова из окна Watch. Смысл и коды - в grid_tie.h.
volatile uint16_t gtCmd = 0;

//---------------------------------------------------------------------------
// Трассировка формы сигналов. Объявления и смысл - в grid_tie.h,
// как этим пользоваться - grid_tie.txt, раздел 6.1.
//
// gtTrcRun = 2 - снимок по событию, как ждущая развёртка осциллографа.
// Пока события нет, буфер пишется по кругу. Событие - смена тока Iset
// или Iq, либо состояния автомата; авария тоже, она переход в GT_FAULT.
// Чем именно запущен снимок - в gtTrcWhy. После него дописывается GT_TRC_LEN - GT_TRC_PRE тактов и запись
// встаёт: в буфере GT_TRC_PRE тактов ДО события и остальное ПОСЛЕ. Фон
// затем переставляет буфер так, что отсчёт 0 - самый старый, а событие
// ложится ровно на отсчёт GT_TRC_PRE.
//
// Прежний снимок писал 40 мс от самой команды, и ступеньку Iref, поданную
// вторым нажатием, не ловил никогда: руками в 40 мс не уложиться. К тому
// же он не сбрасывал индекс и заполнял буфер лишь от текущего места до
// конца - остальное оставалось от старой записи.
//---------------------------------------------------------------------------
// Сами буферы - в RAMGS1. В .bss им места нет: он привязан к ОДНОМУ блоку
// RAMLS5 (0x800 слов), и четыре массива по 200 float (1600 слов) кладут
// линковку намертво. RAMGS1 - 0x2000 слов и пуст; приём в проекте уже
// применяется, см. ErrHistory в KSP/Errors.c.
#pragma DATA_SECTION(gtTrcIref, "ramgs1");
#pragma DATA_SECTION(gtTrcIb, "ramgs1");
#pragma DATA_SECTION(gtTrcIa, "ramgs1");
#pragma DATA_SECTION(gtTrcM, "ramgs1");

uint16_t          gtTrcRun  = 1;
uint16_t          gtTrcIdx  = 0;
uint16_t          gtTrcLeft = 0;
volatile uint16_t gtTrcDone = 0;
uint16_t          gtTrcWhy  = 0;
float    gtTrcIref[GT_TRC_LEN];
float    gtTrcIb[GT_TRC_LEN];
float    gtTrcIa[GT_TRC_LEN];
float    gtTrcM[GT_TRC_LEN];

static void trace_bg(void); // перестановка готового снимка, зовёт фон

// TBCLK1 = 150 МГц / 2 (HSPCLKDIV=2 по сбросу) = 75 МГц, режим UP_DOWN даёт
// 2*TBPRD тактов на период. Отсюда Ts = TBPRD / 37.5e6.
#define TB1_TICKS_PER_SECOND_HALF 37.5e6f

//---------------------------------------------------------------------------
// Начальные значения.
//
// Все коэффициенты - float в структуре gt, чтобы крутить их в отладчике
// на живой цели, не пересобирая проект.
//
// Kp = 2*PI*f_bw*L. Значение f_bw ~ 300 Гц осталось от прежней схемы, когда
// такт управления сидел на прерывании EPWM1 и полная задержка контура была
// около 1.5 такта. Теперь обработчик висит на ADCB INT1 и задержка равна
// 0.5 такта (одна теневая загрузка CMPA), то есть на 300 Гц освободилось
// порядка 21 градуса фазового запаздывания. Потолок полосы от этого вырос,
// но НАСКОЛЬКО - надо мерить на железе, а не назначать: Ts = 200 мкс и шаг
// резонатора никуда не делись. Пока Kp оставлен прежним.
//
// Ki = Kp*w_r, w_r ~ 2*PI*20 - нулевая ошибка на 50 Гц примерно за 50 мс.
//---------------------------------------------------------------------------
void grid_tie_init(void)
{
    gt.State       = GT_OFF;
    gt.fault       = 0;
    gt.faultNew    = 0;
    gt.shutdownReq = 0;
    gt.syncCnt     = 0;
    gt.syncNeed    = 25; // 25 периодов сети = 0.5 с
    gt.startDelay  = 0;
    gt.acContactor = 0;
    gt.gridEn      = 0; // разрешение и запрос приходят из GUI, своего мнения
    gt.connReq     = 0; // о выходе в сеть прошивка при старте не имеет

    gt.IsetRef  = 0.0f;
    gt.Iset     = 0.0f;
    gt.IsetSlew = 0.1f; // А rms за период сети: с нуля до 5 А rms за секунду
    gt.Iq       = 0.0f;

    gt.u220Zero = 2048.0f; // до первого захвата; дальше - середина вилки
    // В/код канала U220. Уточнить при тарировке.
    //
    // До 07.10.2026 стояло 0.152: 311 В пика на 2048 кодов, то есть номинал
    // 220 В ровно в полную шкалу без запаса. Плохо и на железе (230 В +10 % -
    // уже 358 В пика), и на стенде: имитатор сети на DACA заведён на этот же
    // канал, и выше 220 В его было не поднять. 0.2 даёт полную шкалу 289 В
    // действующих, номинал 220 В - это 1556 кодов.
    gt.kU220    = 0.2f;
    gt.iSign    = 1.0f;

    gt.UdcSrc = 0; // на стенде АКБ нет - берём константу

    // gt.n, gt.UdcFixed и gt.Udc здесь БОЛЬШЕ НЕ ЗАДАЮТСЯ. С 25.09.2026 они
    // приходят из паспорта силовой части (my_Files/power_par.h): прибор
    // перестал быть намертво трёхкиловаттным с трансформатором 1:7, и
    // описание конкретной машины живёт в одном месте, во флеше.
    //
    // Раздаёт их power_par_apply(), и зовёт его main() ПОСЛЕ этой функции -
    // иначе заводские литералы затирали бы сохранённый паспорт.

    gt.pr.Kp   = 15.0f;   // = 2*PI*300*0.008
    gt.pr.Ki   = 1900.0f; // = Kp * 2*PI*20
    gt.pr.KiTs = 0.0f;    // считается в grid_tie_onGridZero()
    gt.pr.leak = 0.002f;
    gt.pr.step = 0.0f;
    gt.pr.x1   = 0.0f;
    gt.pr.x2   = 0.0f;
    gt.pr.xMax = 100.0f; // В на вторичке: падение на рассеянии много меньше
    gt.pr.out  = 0.0f;

    // Контур напряжения слежения. Подобрано прогонкой модели с ZOH-объектом
    // (рассеяние 8 мГн, такт 200 мкс) на нагрузке от ХХ до 320 Ом, с
    // задержкой и в один такт (модель), и в два (железо): ошибка копии
    // меньше 0.1 В через 0.1 с во всех случаях.
    //
    // Kp < 1 обязательно: объект по напряжению - почти единица с задержкой,
    // и при Kp >= 1 контур сам раскачивается на половине частоты такта.
    // Утечка в сорок раз меньше, чем у контура тока: при 0.002 резонатор
    // не добирал 2..5 В на нагрузке 16..50 Ом.
    gt.prv.Kp   = 0.3f;
    gt.prv.Ki   = 300.0f; // 1/с
    gt.prv.KiTs = 0.0f;   // считается в grid_tie_onGridZero()
    gt.prv.leak = 5e-5f;
    gt.prv.step = 0.0f;
    gt.prv.x1   = 0.0f;
    gt.prv.x2   = 0.0f;
    gt.prv.xMax = 100.0f; // В: падение под током номинала - десятки вольт
    gt.prv.out  = 0.0f;

    gt.uerr        = 0.0f;
    gt.uGridDly[0] = 0.0f;
    gt.uGridDly[1] = 0.0f;

    gt.mMax = 0.95f;
    gt.m    = 0.0f;

    //-----------------------------------------------------------------
    // Оба медленных контура считает CLA, и параметры их лежат в message RAM,
    // а не в gt (разбор - cla_shared.h). Здесь остаётся только НАЧАЛЬНОЕ
    // СОСТОЯНИЕ: накопители, разрешения, счётчики упора.
    //
    // САМИ КОЭФФИЦИЕНТЫ ЗДЕСЬ БОЛЬШЕ НЕ ЗАДАЮТСЯ - с 25.09.2026 они приходят
    // из структуры reg (my_Files/power_par.h) и переживают выключение: их
    // подбирают под конкретное железо, и терять подбор при снятии питания
    // так же обидно, как терять калибровку АЦП. Заводские значения и довод
    // по каждому числу переехали в power_par.c, к pwr_default.
    //
    // Раздаёт их power_par_apply(), зовёт его main() после этой функции.
    //-----------------------------------------------------------------
    mDC        = 0.0f;
    mDCi       = 0.0f;
    dcAllow    = 0;
    dcResetReq = 0;
    dcSatCnt   = 0;

    uOutAllow    = 0;
    uOutResetReq = 0;
    uOutCor      = 0.0f;
    uOutCorI     = 0.0f;
    uOutSatCnt   = 0;

    // Отсечки по току здесь тоже не задаются: они ВЫВОДЯТСЯ из номинальной
    // мощности паспорта, с тем же запасом 30 %, что стоял в прежнем литерале
    // ("3 кВт -> 19.3 А пика"). Задал другую мощность - пороги пересчитались,
    // и не осталось способа забыть их поправить.
    gt.UdcMin    = 20.0f;
    gt.UdcMax    = 65.0f;
    gt.freqMin   = 47.0f;
    gt.freqMax   = 53.0f;
    gt.uGridMin  = 170.0f; // В действующих
    gt.uGridMax  = 260.0f;
    gt.phaseOk   = 0.10f;
    gt.satCount  = 0;
    gt.satLimit  = 10; // из 100 тактов периода
    gt.satLast   = 0;
    gt.mPeakCur  = 0.0f;
    gt.mPeak     = 0.0f;
    gt.faultMPeak = 0.0f;
    gt.faultSat   = 0;
    gt.gainSat   = 0;
    gt.syncBad   = 0;
    gt.noGrid    = 0;
    gt.noGridMax = 150; // 1.5 периода сети

    gt.Ts     = 200e-6f;
    gt.refSrc = 0; // стенд: опора - daca

    grid_tie_apply_uref();
}

//---------------------------------------------------------------------------
// Быстрая половина контура выходного напряжения острова.
//
//     sineB.gain = 2048 * (uOutRef + uOutCor) * sqrt2 / (n * Udc)
//
// ЗОВЁТСЯ КАЖДЫЙ ТАКТ, из такта управления перед sine_invertor2(). До
// 25.09.2026 звалась только по команде, и это был разомкнутый контур: gain,
// посчитанный один раз, ничего не знал ни о падениях в трансформаторе, ни о
// том, что АКБ под нагрузкой просел.
//
// ДЕЛЕНИЕ НА МГНОВЕННОЕ Udc - половина всей работы контура, и делать его надо
// именно каждый такт. Однофазный мост тянет из звена мощность с пульсацией
// 100 Гц, звено качается с той же частотой (3.3), и прямая связь снимает эту
// качку из амплитуды выхода В ТОТ ЖЕ ТАКТ. Медленному ПИ такое не по зубам в
// принципе: его окно - целый период, он эту пульсацию даже не видит.
//
// Вторая половина - сам ПИ по uSec_rms, он в Cla1Task1. Сюда приходит готовым
// в uOutCor. Разбор связки - grid_tie.txt, 11.
//
// ПОТОЛОК - gt.mMax, А НЕ ЕДИНИЦА. Амплитуда индекса модуляции в острове равна
// gain/2048 (см. вывод в sine_invertor2), и на неё сверху ложится ещё поправка
// постоянки mDC в пределах mDCmax. Прежние 2047 означали бы |m| = 1.0 плюс mDC,
// то есть выход за насыщение компараторов; запас 5 % оставляем тот же, каким
// пользуется контур тока.
//---------------------------------------------------------------------------
#pragma CODE_SECTION(grid_tie_apply_uref, ".TI.ramfunc");

void grid_tie_apply_uref(void)
{
    // Уставка вместе с поправкой контура. Обе в вольтах ДЕЙСТВУЮЩИХ на
    // вторичке, отсюда корень из двух.
    float uref = uOutRef + uOutCor;

    if (uref < 0.0f)
        uref = 0.0f;

    float g    = grid_tie_gain_from_peak(uref * 1.41421356f);
    float gMax = 2048.0f * gt.mMax;

    if (g < 0.0f)
    {
        g = 0.0f;
    }
    else if (g > gMax)
    {
        g = gMax;
        gt.gainSat++; // dbg монотонный счётчик, диагноз по скорости роста
    }

    sineB.gain = g;
}

//---------------------------------------------------------------------------
// Авария. Вызывается из прерывания, поэтому здесь ничего тяжёлого:
// закрыть выход (m = 0 даст нулевое напряжение на мосту в течение одного
// периода ШИМ) и оставить заявку фону. Ни IGBT*_Disable(), ни
// RegisterSessionEvent() из ISR звать нельзя - первые делают EINT внутри
// себя (вложенное прерывание посреди ISR), вторая лезет в журнал и историю.
//---------------------------------------------------------------------------
void grid_tie_fault(uint16_t code)
{
    if (gt.State != GT_FAULT)
    {
        gt.fault    = code;
        gt.faultNew = 1;

        // Запас по m на момент аварии - см. faultMPeak в grid_tie.h. Авария
        // 64 приходит из grid_tie_onGridZero() сразу после публикации
        // mPeak/satLast, то есть это ровно тот период, что её вызвал. Прочие
        // аварии бывают посреди периода - тогда берём худшее из прошлого
        // периода и уже набранной части текущего.
        gt.faultMPeak = (gt.mPeakCur > gt.mPeak) ? gt.mPeakCur : gt.mPeak;
        gt.faultSat   = (gt.satCount > gt.satLast) ? gt.satCount : gt.satLast;
    }
    gt.State       = GT_FAULT;
    gt.Iset        = 0.0f;
    gt.m           = 0.0f;
    gt.acContactor = 0;
    gt.shutdownReq = 1;

    gt.pr.x1  = 0.0f;
    gt.pr.x2  = 0.0f;
    gt.prv.x1 = 0.0f;
    gt.prv.x2 = 0.0f;
}

//---------------------------------------------------------------------------
// Режим, собранный из двух флагов. Отдельной переменной под него нет
// намеренно: она неизбежно разъехалась бы с gridMode и connReq, которые и так
// правятся из нескольких мест (аварии, снятие разрешения, останов).
//---------------------------------------------------------------------------
uint16_t grid_mode_get(void)
{
    if (!gridMode)
        return GRID_MODE_OFF;

    return gt.connReq ? GRID_MODE_GRID : GRID_MODE_SYNC;
}

void grid_tie_start(void)
{
    if (gt.State == GT_OFF)
    {
        gt.syncCnt     = 0;
        gt.startDelay  = 0;
        gt.acContactor = 0; // замкнётся только по команде оператора
        // Запрос выхода в сеть при включении слежения снимаем. Иначе мост,
        // едва набрав синхронизм, ушёл бы в сеть по запросу, отданному до
        // прошлого останова, - а оператор ждёт от слежения холостого хода.
        gt.connReq     = 0;
        gt.Iset        = 0.0f;
        gt.pr.x1       = 0.0f;
        gt.pr.x2       = 0.0f;
        gt.prv.x1      = 0.0f;
        gt.prv.x2      = 0.0f;
        gt.State       = GT_SYNC;

        // Поправку постоянки начинаем с нуля. Прямая запись mDC тут не
        // годится: раз в сто тактов она пришлась бы на тот самый такт, где
        // mDC пишет CLA, и сброс молча пропал бы. Просим её сама.
        dcResetReq++;

        // Состояние модели здесь больше не сбрасывается. Модель - это железо,
        // а железо от нажатия кнопки "пуск" токи себе не обнуляет: при
        // разомкнутом контакторе ток вторички и так ноль, а намагничивание
        // живёт своей жизнью, пока мост модулирует.
    }
}

void grid_tie_stop(void)
{
    gt.State       = GT_OFF;
    gt.fault       = 0;
    gt.faultNew    = 0;
    gt.Iset        = 0.0f;
    gt.m           = 0.0f;
    gt.syncCnt     = 0;
    gt.startDelay  = 0;
    gt.acContactor = 0;
    gt.connReq     = 0;
    gt.pr.x1       = 0.0f;
    gt.pr.x2       = 0.0f;
    gt.prv.x1      = 0.0f;
    gt.prv.x2      = 0.0f;
    gt.shutdownReq = 1;
}

//---------------------------------------------------------------------------
// Уход из сети обратно в слежение: GT_RAMP / GT_RUN -> GT_SYNC. В прочих
// состояниях ничего не делает.
//
// Размыкаем контактор и возвращаемся в GT_SYNC. Это НЕ авария - следующий
// выход в сеть не требует ни сброса аварии, ни перезапуска слежения.
//
// Зовут двое, и оба из прерываний, так что такт контура между строк не влезет:
//   grid_tie_onGridZero()  оператор снял запрос ("Откл.") или разрешение
//                          (галочка Enable); мост продолжает модулировать
//                          клон сети вхолостую
//   cmd_MBOX28()           команды сеанса - "Подключить", "Отключить",
//                          закрытие окна, - которые следом закрывают ключи.
//                          Без этого выхода закрытые ключи при замкнутом
//                          контакторе давали аварию 68, см. session_keys_off()
//
// syncCnt обнуляем: качество захвата после коммутации надо набрать
// заново, иначе повторное замыкание случилось бы в тот же период.
//
// Ток сбрасывается разом, без рампы - так же, как в grid_tie_stop().
// Пока acContactor живёт только в модели, это безразлично; когда под реле
// выделят GPIO, размыкание придётся делать по нулю тока, а до него
// спускать Iset рампой.
//---------------------------------------------------------------------------
void grid_tie_leave_grid(void)
{
    if ((gt.State != GT_RAMP) && (gt.State != GT_RUN))
        return;

    gt.acContactor = 0;
    gt.Iset        = 0.0f;
    gt.syncCnt     = 0;
    gt.startDelay  = 0;

    // Обратная передача поправки, см. замыкание в grid_tie_step().
    gt.prv.x1 = gt.pr.x1;
    gt.prv.x2 = gt.pr.x2;

    gt.State       = GT_SYNC;

    // Поправку постоянки - с нуля, как и при пуске. Запросом, а не
    // прямой записью: mDC теперь хозяйство CLA.
    dcResetReq++;
}

//---------------------------------------------------------------------------
// Фоновая часть: то, чему не место в прерывании.
// Вызывается из while(1) в main.c.
//---------------------------------------------------------------------------
void grid_tie_background(void)
{
    // Команда из отладчика. Стоит ПЕРЕД разбором shutdownReq не случайно:
    // grid_tie_stop() его как раз и взводит, и ключи должны закрыться в этом
    // же проходе фона, а не в следующем.
    if (gtCmd)
    {
        uint16_t cmd = gtCmd;
        gtCmd        = 0;

        // Автомат живёт в прерывании, поэтому его состояние меняем с
        // закрытыми прерываниями. Иначе такт контура успеет влезть между
        // сбросом резонатора и сменой State и досчитает период с
        // полуобнулённым состоянием.
        DINT;
        if (cmd == 1)
            grid_tie_stop();
        else if (cmd == 2)
            grid_tie_start();
        EINT;
    }

    if (gt.shutdownReq)
    {
        gt.shutdownReq = 0;
        IGBT1_Disable();
        IGBT2_Disable();
    }

    if (gt.faultNew)
    {
        gt.faultNew = 0;
        RegisterSessionEvent(gt.fault);
    }

    trace_bg();

    //-----------------------------------------------------------------
    // Упор поправки постоянки. ЗАПИСЬ В ЖУРНАЛ, БЕЗ ОСТАНОВА.
    //
    // Что это значит. mDCmax выбран из "сколько нужно для компенсации"
    // (мёртвое время просит 0.01, взят двойной запас), а НЕ из "сколько
    // сердечник стерпит". Значит упор - это не "контур старается", а
    // "помеха больше всех моих полномочий": контур делает что может и
    // проигрывает, поток каждый период стоит не по центру.
    //
    // Почему не авария. Ключи бережёт компаратор CMPSS2 по линии TRIP5,
    // аппаратно; на обвал индуктивности программа не успевает в принципе,
    // и подменять её тут нечем. А то, что ловит этот счётчик, - случай
    // ХРОНИЧЕСКИЙ: сердечник у колена, лишние потери, искажённая форма,
    // но ток целиком под порогом компаратора, потому что тот стоит на
    // 30 % выше приведённого тока нагрузки, и запас этот заведён как раз
    // под ток намагничивания. Останавливать по нему мост - решение
    // отдельное и пока не принятое; разбор - grid_tie.txt, 3.1.5.
    //
    // Зовётся отсюда, а не из grid_tie_onGridZero(), где живёт проверка
    // gt_mSat: ту функцию взводит захват нуля сети, и в АИН без сети она
    // может не отработать ни разу. А первым с железом включат как раз АИН.
    // Фон же крутится в while(1) безусловно. Заодно только отсюда и можно
    // звать RegisterSessionEvent() - из ISR ей в журнал нельзя.
    //
    // По фронту: фон проходит тысячи раз за то время, пока серия держится.
    //-----------------------------------------------------------------
    static uint16_t dcSatSeen = 0;

    if (dcSatCnt > dcSatLimit)
    {
        if (!dcSatSeen)
        {
            dcSatSeen = 1;
            RegisterSessionEvent(gt_dcSat);
        }
    }
    else if (dcSatCnt == 0)
    {
        // Взводим обратно только на полном выходе из упора, а не как только
        // счётчик опустился ниже порога: иначе дрожание около него дало бы
        // очередь записей об одном и том же событии.
        dcSatSeen = 0;
    }

    //-----------------------------------------------------------------
    // Упор контура выходного напряжения острова. ТОЖЕ ЗАПИСЬ В ЖУРНАЛ,
    // БЕЗ ОСТАНОВА, и по тому же устройству, что блок выше.
    //
    // Смысл события другой. Там контур проигрывал ПОМЕХЕ, здесь он упёрся в
    // ФИЗИКУ: уставку не вытянуть из того, что есть. Причин ровно три, и все
    // три смотрятся в соседних величинах -
    //
    //     просел АКБ            uBat_volt, gt.Udc
    //     мал коэффициент n     gt.n против измеренного Uвтор/Uперв
    //     нагрузка больше       iSec_rms, pSec
    //
    // и разбираются они по 3.2: запас по индексу модуляции - узкое место всей
    // схемы. Рядом обычно бежит и gt.gainSat: прямая связь упирается в потолок
    // раньше, чем ПИ успевает набрать свой.
    //
    // Почему не авария. Мост при этом работает совершенно исправно, просто
    // выдаёт меньше запрошенного, и форма портится только на пиках. Гасить
    // из-за этого остров - значит по просадке АКБ снимать нагрузку, которая
    // и так уже питается. Решение об останове остаётся за оператором.
    //-----------------------------------------------------------------
    static uint16_t uOutSatSeen = 0;

    if (uOutSatCnt > uOutSatLimit)
    {
        if (!uOutSatSeen)
        {
            uOutSatSeen = 1;
            RegisterSessionEvent(gt_uOutSat);
        }
    }
    else if (uOutSatCnt == 0)
    {
        uOutSatSeen = 0;
    }
}

//---------------------------------------------------------------------------
// Измерения тракта: напряжение сети и напряжение звена.
//
// Живут отдельно от такта контура, потому что нужны РАНЬШЕ него: следом за
// этой функцией и до grid_tie_step() идёт такт модели, которому gt.uGrid
// служит ЭДС сети. Разбор - в объявлении в grid_tie.h.
//
// Зовётся в обоих режимах моста, в том числе в АИН: обе величины полезны как
// показания и стоят недорого.
//---------------------------------------------------------------------------
#pragma CODE_SECTION(grid_tie_measure, ".TI.ramfunc");

void grid_tie_measure(void)
{
    // Напряжение сети. Берём СЫРОЙ отсчёт и вычитаем измеренный ноль.
    // ADCPPB1RESULT здесь не годится: в ADCPPB1OFFREF лежит калибровочный
    // офсет канала (110), а не середина шкалы, так что "знаковый" результат
    // PPB несёт постоянное смещение почти в 2000 кодов. С ним индекс
    // модуляции полпериода стоит в упоре по mMax.
    gt.uGridKod = (int16_t)((float)u220_kod - gt.u220Zero);
    gt.uGrid    = gt.kU220 * (float)gt.uGridKod;

    // Напряжение АКБ. Мгновенное, не сглаженное - см. комментарий в grid_tie.h.
    if (gt.UdcSrc)
    {
        // На модели канал uBat пишет plant_sim_step(), и лезть за ним в
        // регистр PPB бессмысленно: там висит реальный вход, на стенде ни к
        // чему не подключённый. Значение прошлого такта для напряжения АКБ -
        // не запаздывание, а то же самое число.
        gt.Udc = sim.on ? uBat_volt
                        : kadcf.uBat * (float)(int16_t)AdcaResultRegs.ADCPPB2RESULT.bit.PPBRESULT;
    }
    else
    {
        gt.Udc = gt.UdcFixed;
    }

    //-----------------------------------------------------------------
    // Разрешение контуру подавления постоянки править mDC. Сам контур
    // считает CLA, а знание о том, работает ли мост, живёт здесь - вот
    // и весь обмен: одно слово в такт.
    //
    // Место выбрано потому, что эта функция - единственная, которую
    // зовут КАЖДЫЙ ТАКТ И В ОБОИХ РЕЖИМАХ. Дальше по такту дороги
    // расходятся: в сети grid_tie_step(), в острове sine_invertor2().
    //
    // В СЕТИ разрешаем во всех состояниях, где мост модулирует, включая
    // GT_SYNC. Раньше GT_SYNC был исключён, и это была дыра: контактор
    // там разомкнут, но мост уже работает, поток копится, а следить за
    // ним некому, причём не меньше полусекунды (syncNeed). Разбор -
    // grid_tie.txt, 3.1.7.
    //
    // В ОСТРОВЕ признак один - открытые ключи. При закрытых тока нет
    // вовсе (на модели он тождественно ноль, на железе остаётся
    // смещение нуля датчика), и интегратор уехал бы в потолок,
    // компенсируя то, чего не существует.
    //-----------------------------------------------------------------
    dcAllow = gridMode ? ((gt.State == GT_SYNC) || (gt.State == GT_RAMP) ||
                          (gt.State == GT_RUN))
                       : motors[0]->flag.bit.pwm_On;

    //-----------------------------------------------------------------
    // То же самое для контура выходного напряжения острова, и место у него
    // здесь по той же причине: одна функция на оба режима, один живой сигнал
    // в такт, разойтись нечему.
    //
    // Условия два, и оба обязательны. gridMode = 0 - потому что в сетевом
    // режиме амплитудой заведует слежение за огибающей сети (u220_sample в
    // myADC.c), и два регулятора на один sineB.gain дрались бы. Открытые
    // ключи - потому что при закрытых uSec_rms лежит в нуле (на модели
    // тождественно, на железе в шумах датчика), и интегратор за секунду
    // уехал бы в потолок, компенсируя напряжение, которого никто не просил.
    //
    // ФРОНТ 0 -> 1 СБРАСЫВАЕТ ПОПРАВКУ. Остров обязан начинаться с чистой
    // прямой связи: поправка, накопленная в прошлом опыте (другая нагрузка,
    // другое звено), ушла бы в мост первым же тактом. Запросом, а не прямой
    // записью, - uOutCor хозяйство CLA, и прямая запись раз в сто тактов
    // пришлась бы на тот самый такт, где её пишет задача.
    //-----------------------------------------------------------------
    {
        uint16_t allow = (!gridMode) && motors[0]->flag.bit.pwm_On;

        if (allow && !uOutAllow)
            uOutResetReq++;

        uOutAllow = allow;
    }
}

//---------------------------------------------------------------------------
// Такт контура тока. Вызывается из INT_myADCB_1_ISR, 100 раз за период сети,
// следом за grid_tie_measure() и тактом модели plant_sim_step().
//
// Порядок важен: сначала модель отрабатывает ПРЕДЫДУЩИЙ индекс модуляции
// (тот, что реально стоял в CMPA последний период), и только потом считается
// новый. Иначе модель окажется на такт быстрее реальности.
//---------------------------------------------------------------------------
#pragma CODE_SECTION(grid_tie_step, ".TI.ramfunc");

void grid_tie_step(void)
{
    // Измерения уже сделаны grid_tie_measure(), токи - либо прочитаны с АЦП
    // в xfmr_currents_from_adc(), либо подменены моделью в plant_sim_step().

    //-----------------------------------------------------------------
    // 1. Защиты. Работают всегда, в любом состоянии.
    //-----------------------------------------------------------------
    if (++gt.noGrid > gt.noGridMax)
    {
        // Захватов eCAP нет больше полутора периодов. Без этой проверки
        // TBPRD и step замирают на последних значениях, а мост продолжает
        // работать "по памяти" - в сеть так нельзя.
        gt.noGrid = gt.noGridMax; // не даём переполниться
        if (gt.State == GT_RAMP || gt.State == GT_RUN)
            grid_tie_fault(gt_noGrid);
    }

    // Ключи открыты? Нужно и защитам ниже, и контуру в разделе 2.
    uint16_t keysOn = motors[0]->flag.bit.pwm_On;

    if (gt.State == GT_RAMP || gt.State == GT_RUN)
    {
        // Ключи закрыли при замкнутом контакторе - оператор кнопкой питания
        // или компараторная защита (у неё своя индикация, здесь только
        // следствие). Отдельный код, а не молчаливый уход в слежение, -
        // решение пользователя 08.10.2026. До того контур тока при закрытых
        // ключах за период упирался в m и приходила авария 64, сбивавшая с
        // толку: про запас по напряжению она тут ничего не говорит.
        if (!keysOn)
            grid_tie_fault(gt_keysOff);
        else if (fabsf(iPri_amp) > gt.ImaxPri)
            grid_tie_fault(gt_overIpri);
        else if (fabsf(iSec_amp) > gt.ImaxSec)
            grid_tie_fault(gt_overIsec);
        else if (gt.UdcSrc && ((gt.Udc < gt.UdcMin) || (gt.Udc > gt.UdcMax)))
            grid_tie_fault(gt_UdcRange);
    }

    //-----------------------------------------------------------------
    // 2. Контур: напряжения в GT_SYNC, тока в GT_RAMP / GT_RUN
    //-----------------------------------------------------------------
    // Оба - PR поверх прямой связи по сети, разница только в ошибке:
    //
    //   GT_SYNC  контактор разомкнут, мост держит КОПИЮ СЕТИ на выходе.
    //            Ошибка - сеть минус выход инвертора, регулятор gt.prv.
    //            К замыканию контактора разность на его контактах нулевая
    //            при любой нагрузке, и переход в GT_RAMP безударный.
    //
    //   GT_RAMP  контактор замкнут, сеть держит напряжение сама, мост
    //   GT_RUN   регулирует свой ток. Ошибка - уставка минус iSec, gt.pr.
    //
    // До 07.10.2026 GT_SYNC считал контур ТОКА с нулевой уставкой. На
    // холостом ходу это одно и то же, но датчик iSec стоит перед
    // нагрузкой, и с нагрузкой контур давил её ток, роняя напряжение.
    // Разбор - у поля prv в grid_tie.h.
    //
    // СЛЕЖЕНИЕ ТОЛЬКО ПРИ ОТКРЫТЫХ КЛЮЧАХ (08.10.2026). Режим моста и ключи -
    // разные органы, и "Выход в сеть" можно нажать при закрытых ключах. Тогда
    // выход моста ноль, ошибка контура напряжения - вся сеть, и резонатор
    // наматывал её до xMax = 100 В. Синхронизм же считается по одной сети и
    // набирался своим чередом, контактор замыкался при закрытых ключах, а
    // контур тока получал в наследство эти 100 В: m = 1.2 с первого периода
    // и авария 64. Теперь при закрытых ключах слежение стоит: контур не
    // считается, интегратор держится в нуле, синхронизм не набирается (см.
    // GT_SYNC в grid_tie_onGridZero()). В сети закрытые ключи - авария
    // gt_keysOff, см. защиты выше.
    if ((gt.State == GT_SYNC && keysOn) || gt.State == GT_RAMP || gt.State == GT_RUN)
    {
        struct PRreg *p;
        float         err;

        if (gt.State == GT_SYNC)
        {
            // Сеть того такта, к которому относится uSec_volt, - см.
            // uGridDly в grid_tie.h.
            float uRef = sim.on ? gt.uGridDly[0] : gt.uGridDly[1];

            gt.iref = 0.0f;
            gt.ierr = 0.0f;
            gt.uerr = uRef - uSec_volt;

            p   = &gt.prv;
            err = gt.uerr;
        }
        else
        {
            // Угол сети - тот же, по которому идёт вся синхронизация.
            // Берём ДО приращения, как это делает sine_invertor1().
            float theta = sineB.angle + sineB.offset;

            // Уставки в действующих (см. IsetRef в grid_tie.h), а iref -
            // мгновенный ток, поэтому sqrt2 ровно здесь и больше нигде.
            gt.iref = gt.Iset * sinf(theta);
            if (gt.Iq != 0.0f)
                gt.iref += gt.Iq * cosf(theta);
            gt.iref *= 1.41421356f;

            gt.ierr = gt.iref - iSec_amp;
            gt.uerr = 0.0f;

            p   = &gt.pr;
            err = gt.ierr;
        }

        // PR: пропорциональная часть плюс резонатор ровно на частоте сети.
        // Состояние сохраняем - при упоре по m его придётся откатить.
        float x1old = p->x1;
        float x2old = p->x2;

        p->x1 += p->step * p->x2 + p->KiTs * err - p->leak * p->x1;
        p->x2 -= p->step * p->x1;

        if (p->x1 > p->xMax)
            p->x1 = p->xMax;
        else if (p->x1 < -p->xMax)
            p->x1 = -p->xMax;

        p->out = p->Kp * err + p->x1;

        // Прямая связь по сети снимает с регулятора всю основную синусоиду:
        // PR остаётся отрабатывать только падение на рассеянии и обмотках,
        // а это единицы, под нагрузкой - десятки вольт.
        gt.uSec = gt.uGrid + p->out;

        // Коэффициент трансформации входит ровно один раз, здесь.
        float denom = gt.n * gt.Udc;
        gt.m        = (denom > 1.0f) ? (gt.uSec / denom + mDC) : 0.0f;

        // Пик запроса за период - до клампа, см. mPeak в grid_tie.h
        if (fabsf(gt.m) > gt.mPeakCur)
            gt.mPeakCur = fabsf(gt.m);

        if ((gt.m > gt.mMax) || (gt.m < -gt.mMax))
        {
            gt.m = (gt.m > 0.0f) ? gt.mMax : -gt.mMax;

            // Упор. Интегратор в упоре наматывать не должен - откатываем.
            p->x1 = x1old;
            p->x2 = x2old;
            gt.satCount++;
        }

    }
    else
    {
        // GT_OFF / GT_FAULT, либо слежение при закрытых ключах: оба плеча на
        // 50 %, напряжение моста равно нулю.
        gt.m       = 0.0f;
        gt.pr.out  = 0.0f;
        gt.prv.out = 0.0f;
        gt.uerr    = 0.0f;

        // Эти два контур пишет только когда считается. Без обнуления в ленте
        // F3_grid (и на отладочном ЦАП) оставалось бы последнее значение -
        // прямая линия, неотличимая от настоящего сигнала.
        gt.ierr = 0.0f;
        gt.uSec = 0.0f;

        // Слежение начнётся с чистого резонатора, когда ключи откроют.
        if (gt.State == GT_SYNC)
        {
            gt.prv.x1 = 0.0f;
            gt.prv.x2 = 0.0f;
        }
    }

    // История сети для контура напряжения - каждый такт и в любом
    // состоянии, чтобы на входе в GT_SYNC она уже была правдой.
    gt.uGridDly[1] = gt.uGridDly[0];
    gt.uGridDly[0] = gt.uGrid;

    // Отсчёт четверти периода от нуля напряжения до замыкания контактора -
    // см. взвод startDelay в grid_tie_onGridZero(). Поток есть интеграл
    // напряжения, поэтому замыкание в максимуме даёт нулевое начальное
    // смещение потока.
    // Ключи закрыли посреди отсчёта - пуск отменяется, контактор не трогаем.
    if ((gt.State == GT_SYNC) && !keysOn)
        gt.startDelay = 0;

    if ((gt.State == GT_SYNC) && (gt.startDelay > 0))
    {
        if (--gt.startDelay == 0)
        {
            // Контур тока подхватывает поправку контура напряжения: оба
            // добавляют своё к одной и той же прямой связи uGrid, и
            // резонаторы у них на одной частоте. Иначе в момент замыкания
            // пропала бы поправка на падение под током нагрузки.
            gt.pr.x1 = gt.prv.x1;
            gt.pr.x2 = gt.prv.x2;

            gt.Iset        = 0.0f;
            gt.acContactor = 1;
            gt.State       = GT_RAMP;
        }
    }

    //-----------------------------------------------------------------
    // 3. Вывод в компараторы
    //
    // Режим UP_DOWN, UP_CMPA -> HIGH, DOWN_CMPA -> LOW, значит доля высокого
    // уровня плеча = 1 - CMPA/TBPRD. При CMPA_A = TBPRD*(1-m)/2 получается
    // dA = (1+m)/2, dB = (1-m)/2 и U_AB = m*Udc.
    //
    // Окна открытого состояния обоих плеч отцентрированы по вершине счётчика,
    // поэтому узкое вложено в широкое: U_AB принимает только 0 и +Udc (либо
    // 0 и -Udc). Это трёхуровневая модуляция, частота пульсации вдвое выше
    // несущей. Ломать это соотношение CMPA нельзя.
    //-----------------------------------------------------------------
    {
        uint16_t tbprd = EPwm1Regs.TBPRD;
        float    ca    = (float)tbprd * 0.5f * (1.0f - gt.m);

        if (ca < 0.0f)
            ca = 0.0f;
        else if (ca > (float)tbprd)
            ca = (float)tbprd;

        cmpaA = (uint16_t)ca;
        cmpaB = tbprd - cmpaA;

        EPwm1Regs.CMPA.bit.CMPA = cmpaA;
        EPwm2Regs.CMPA.bit.CMPA = cmpaB;
    }

    //-----------------------------------------------------------------
    // 4. Угол.
    //
    // В обычном режиме его двигают sine_invertor1/2. Раз мы их заменили,
    // двигать обязаны сами - иначе встанет весь PLL: и подстройка фазы,
    // и dacb, и детектор нуля.
    //-----------------------------------------------------------------
    sineB.angle = asut(sineB.angle + sineB.step);

    //-----------------------------------------------------------------
    // 5. Трассировка формы. Четыре записи в ОЗУ, на такт незаметно.
    //
    // Пишется в самом конце: к этому моменту в gt лежит согласованный
    // срез одного и того же такта - iref, измеренный ток и тот m, который
    // только что ушёл в CMPA.
    //
    // Событие сравнивается с прошлым тактом, а не ловится в местах смены:
    // состояние меняют и автомат, и grid_tie_fault(), и команды по CAN, и
    // так не пропустить ни одного. Старые значения обновляются каждый такт
    // в любом режиме записи - иначе взвод снимка сработал бы сам на давно
    // прошедшей смене.
    //
    // Ток - по gt.Iset, а не по уставке IsetRef. Уставка доходит до Iset
    // только на переходе сети через ноль (рампа в grid_tie_onGridZero), то
    // есть на 0..20 мс позже нажатия. Запуск по IsetRef ставил событие на
    // отсчёт 50, а сама ступенька уезжала вправо, вплоть до края окна.
    // Iq в iref идёт сразу, ему рампы нет - он сравнивается как есть.
    //-----------------------------------------------------------------
    static uint16_t trcRunOld   = 0;
    static uint16_t trcStateOld = GT_OFF;
    static float    trcIsetOld  = 0.0f;
    static float    trcIqOld    = 0.0f;

    // RUN <-> RAMP событием НЕ считается. Это след смены уставки, а не
    // своё событие: на первом нуле сети после нажатия автомат лишь уходит
    // RUN -> RAMP, а Iset трогает только на следующем, через период. Запуск
    // по этому переходу увозил ступеньку тока на отсчёт 150 - поймано
    // 09.10.2026, gtTrcWhy = 1. Саму смену ловит Iset.
    uint16_t trcCur   = (gt.State == GT_RAMP) || (gt.State == GT_RUN);
    uint16_t trcWas   = (trcStateOld == GT_RAMP) || (trcStateOld == GT_RUN);
    uint16_t trcEvent = 0;
    if ((gt.State != trcStateOld) && !(trcCur && trcWas))
        trcEvent |= GT_TRC_WHY_STATE;
    if (gt.Iset != trcIsetOld)
        trcEvent |= GT_TRC_WHY_ISET;
    if (gt.Iq != trcIqOld)
        trcEvent |= GT_TRC_WHY_IQ;
    trcStateOld = gt.State;
    trcIsetOld  = gt.Iset;
    trcIqOld    = gt.Iq;

    if ((gtTrcRun == 2) && (trcRunOld != 2))
    {
        // Снимок только что взведён: ждём события. Предыстория набирается
        // за GT_TRC_PRE тактов, 10 мс, - руками раньше не успеть.
        gtTrcLeft = 0;
        gtTrcDone = 0;
        gtTrcWhy  = 0;
    }
    trcRunOld = gtTrcRun;

    // gtTrcDone - снимок записан и ждёт перестановки в фоне. Писать в
    // буфер, который фон в это время переставляет, нельзя.
    if (gtTrcRun && !gtTrcDone)
    {
        if ((gtTrcRun == 2) && (gtTrcLeft == 0) && trcEvent)
        {
            gtTrcLeft = GT_TRC_LEN - GT_TRC_PRE; // отсчёт события - первый из них
            gtTrcWhy  = trcEvent;
        }

        gtTrcIref[gtTrcIdx] = gt.iref;
        gtTrcIb[gtTrcIdx]   = iSec_amp;
        gtTrcIa[gtTrcIdx]   = iPri_amp;
        gtTrcM[gtTrcIdx]    = gt.m;

        if (++gtTrcIdx >= GT_TRC_LEN)
            gtTrcIdx = 0;

        if (gtTrcLeft && (--gtTrcLeft == 0))
            gtTrcDone = 1; // окно записано, дальше - фон
    }
}

//---------------------------------------------------------------------------
// Перестановка снимка, из фона. Буфер кольцевой, и после записи самый
// старый отсчёт лежит там, куда указывает gtTrcIdx. CCS Graph рисует от
// нулевого элемента, поэтому кольцо поворачивается на месте - три
// разворота, без второго буфера. В прерывании этого не сделать: 800 пар
// перестановок за раз - заметная доля такта, а в фоне спешить некуда.
//---------------------------------------------------------------------------
static void trc_reverse(float *a, uint16_t i, uint16_t j)
{
    while (i < j)
    {
        float t = a[i];
        a[i++]  = a[j];
        a[j--]  = t;
    }
}

static void trc_rotate(float *a, uint16_t k)
{
    trc_reverse(a, 0, k - 1);
    trc_reverse(a, k, GT_TRC_LEN - 1);
    trc_reverse(a, 0, GT_TRC_LEN - 1);
}

static void trace_bg(void)
{
    if (!gtTrcDone)
        return;

    uint16_t k = gtTrcIdx;
    if (k != 0)
    {
        trc_rotate(gtTrcIref, k);
        trc_rotate(gtTrcIb, k);
        trc_rotate(gtTrcIa, k);
        trc_rotate(gtTrcM, k);
    }
    gtTrcIdx = 0;

    // Порядок обязателен: сперва стоп, потом снять gtTrcDone. Наоборот -
    // прерывание между ними увидит взведённый снимок без флага и допишет
    // отсчёт в уже повёрнутый буфер. Если оператор успел сменить режим,
    // его выбор не трогаем.
    if (gtTrcRun == 2)
        gtTrcRun = 0;
    gtTrcDone = 0;
}

//---------------------------------------------------------------------------
// Раз за период сети, из INT_U220_zero_ECAP_ISR.
// Здесь живёт всё медленное: автомат и нарастание уставки.
//
// Контура DC здесь больше нет. Он уехал в Cla1Task1 целиком - и усреднение,
// и интегратор, и ограничение, - а вместе с ним ушли обе обёртки, которые
// стояли тут: grid_tie_mdc_period() для сети и grid_tie_dc_island() для
// острова. Держать два окна на одну величину было нечем оправдать: окно CLA
// (rmsWindow тактов) годится обоим, разбор - grid_tie.txt, 3.1.4.
//---------------------------------------------------------------------------
void grid_tie_onGridZero(void)
{
    // Сеть есть - сторож перезаряжен.
    gt.noGrid = 0;

    //-----------------------------------------------------------------
    // Пересчёт периода дискретизации и коэффициентов, зависящих от него.
    // TBPRD правится тем же прерыванием при каждом захвате, так что Ts
    // надо освежать здесь же.
    //-----------------------------------------------------------------
    gt.Ts      = (float)EPwm1Regs.TBPRD * (1.0f / TB1_TICKS_PER_SECOND_HALF);
    gt.pr.KiTs = gt.pr.Ki * gt.Ts;
    gt.pr.step = sineB.step; // резонанс автоматически едет за частотой сети

    gt.prv.KiTs = gt.prv.Ki * gt.Ts;
    gt.prv.step = sineB.step;

    // Ноль канала U220 - СРЕДНЕЕ сырых кодов за окно CLA (u220_av).
    // Обновляем раз за период: чаще незачем, а к калибровочному офсету PPB
    // привязываться нельзя (см. grid_tie.h).
    //
    // До 08.10.2026 здесь стояла середина вилки огибающей, и на стенде она
    // расходилась со средним на три кода, 0.6 В. Прямая связь несла эту
    // ошибку в мост постоянкой, а контур постоянки с ней не справлялся:
    // пропорциональная часть контура тока для постоянки - резистор
    // Kp = 15 Ом, и mDC упирался в потолок, оставляя 2.5 А в первичке.
    // Разбор - в Task1.cla, у накопителя u220_sum.
    //
    // Вилка остаётся запасным нулём, пока CLA не закрыла первое окно: секция
    // cla_shared начальных значений не имеет, и в u220_av может лежать что
    // угодно. NaN не проходит ни одно из сравнений и тоже уходит на вилку.
    // Правдоподобный мусор проживёт одно окно - до замыкания контактора
    // слежение идёт не меньше полусекунды (syncNeed), так что безвредно.
    {
        float av = u220_av;

        gt.u220Zero = ((av > 1.0f) && (av < 4094.0f))
                          ? av
                          : ((float)u220hi_kod + (float)u220low_kod) * 0.5f;
    }

    //-----------------------------------------------------------------
    // Качество синхронизма за прошедший период
    //-----------------------------------------------------------------
    // Напряжение сети из полураствора вилки огибающей, В действующих. Окно
    // в вольтах, чтобы перетарировка kU220 его не сдвигала.
    float uGridRms = u220amp * gt.kU220 * 0.70710678f;

    uint16_t gridOk = ((u220freq >= gt.freqMin) && (u220freq <= gt.freqMax) &&
                       (uGridRms >= gt.uGridMin) && (uGridRms <= gt.uGridMax) &&
                       (fabsf(phaseErr) < gt.phaseOk))
                          ? 1U
                          : 0U;

    // dbg Разложение того же условия по причинам. Условия ЗЕРКАЛЬНЫ к gridOk
    // выше (там >= и <=, здесь < и >), иначе значение на самой границе окна
    // дало бы gridOk = 0 при пустой маске - и разбор увёл бы не туда.
    //
    // В GT_FAULT замирает: маска и нужна как снимок момента срыва. Смысл
    // битов и комбинаций - в grid_tie.h.
    if (gt.State != GT_FAULT)
    {
        gt.syncBad = (((u220freq < gt.freqMin) || (u220freq > gt.freqMax)) ? 1U : 0U) |
                     (((uGridRms < gt.uGridMin) || (uGridRms > gt.uGridMax)) ? 2U : 0U) |
                     ((fabsf(phaseErr) >= gt.phaseOk) ? 4U : 0U);
    }

    //-----------------------------------------------------------------
    // Систематический упор по m - это не помеха, а диагноз: либо просел
    // АКБ, либо мал коэффициент трансформации, либо сердечник не тянет.
    // Тихо портить форму тока в такой ситуации нельзя.
    //-----------------------------------------------------------------
    gt.satLast  = gt.satCount;
    gt.satCount = 0;

    gt.mPeak    = gt.mPeakCur;
    gt.mPeakCur = 0.0f;

    // Оператор снял запрос (кнопка "Откл.") или разрешение (галочка Enable) -
    // уходим из сети обратно в слежение.
    if (!gt.connReq || !gt.gridEn)
        grid_tie_leave_grid();

    switch (gt.State)
    {
        case GT_SYNC:
            // Синхронизм - это совпадение ВЫХОДА МОСТА с сетью, а не одной
            // сети: при закрытых ключах выхода нет, и считать нечего. Без
            // этого контактор замыкался при закрытых ключах - разбор у
            // keysOn в grid_tie_step().
            if (gridOk && motors[0]->flag.bit.pwm_On)
            {
                if (gt.syncCnt < gt.syncNeed)
                    gt.syncCnt++;

                // Условие взвода - именно ">=", а не "==". syncNeed объявлен
                // крутилкой отладчика, и если его понизить на ходу, счётчик
                // окажется уже выше порога: со строгим равенством пуск после
                // этого не наступит никогда.
                // Повторный взвод невозможен: замыкание контактора выводит
                // автомат из GT_SYNC и ставит acContactor.
                //
                // Синхронизм больше не пускает в сеть сам. Набранный syncCnt -
                // это разрешение автомата, а решение принимает оператор:
                // connReq (кнопка "Сеть") при поднятом gridEn (галочка Enable).
                // Без них автомат остаётся в GT_SYNC сколь угодно долго - в
                // этом и смысл слежения: мост держит клон сети вхолостую, и
                // его можно спокойно сверить с сетью осциллографом.
                if ((gt.syncCnt >= gt.syncNeed) && (gt.startDelay == 0) &&
                    (gt.acContactor == 0) && gt.connReq && gt.gridEn)
                {
                    // Пуск смещён на четверть периода от нуля напряжения,
                    // то есть в его максимум: поток - интеграл напряжения,
                    // и замыкание в максимуме даёт нулевое начальное смещение.
                    // Досчитывает startDelay уже grid_tie_step().
                    gt.startDelay = sineB.resolution / 4;
                }
            }
            else
            {
                gt.syncCnt    = 0;
                gt.startDelay = 0;
            }
            break;

        case GT_RAMP:
            if (!gridOk)
            {
                grid_tie_fault(gt_syncLost);
                break;
            }
            if (gt.satLast > gt.satLimit)
            {
                grid_tie_fault(gt_mSat);
                break;
            }

            // Рампа в обе стороны. Скачок вниз перегрузки не даёт, но резкий
            // сброс тока - это ступенька напряжения на индуктивности рассеяния
            // и лишний бросок в сердечник. Спускаемся так же плавно.
            if (gt.Iset < gt.IsetRef)
            {
                gt.Iset += gt.IsetSlew;
                if (gt.Iset >= gt.IsetRef)
                {
                    gt.Iset  = gt.IsetRef;
                    gt.State = GT_RUN;
                }
            }
            else if (gt.Iset > gt.IsetRef)
            {
                gt.Iset -= gt.IsetSlew;
                if (gt.Iset <= gt.IsetRef)
                {
                    gt.Iset  = gt.IsetRef;
                    gt.State = GT_RUN;
                }
            }
            else
            {
                gt.State = GT_RUN;
            }
            break;

        case GT_RUN:
            if (!gridOk)
            {
                grid_tie_fault(gt_syncLost);
                break;
            }
            if (gt.satLast > gt.satLimit)
            {
                grid_tie_fault(gt_mSat);
                break;
            }

            // Уставку можно менять на ходу, но только через нарастание.
            if (gt.Iset != gt.IsetRef)
                gt.State = GT_RAMP;
            break;

        case GT_OFF:
        case GT_FAULT:
        default:
            gt.syncCnt = 0;
            break;
    }
}
