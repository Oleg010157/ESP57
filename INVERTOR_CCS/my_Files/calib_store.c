/*
 * calib_store.c
 *
 * Хранение калибровок АЦП во флеше. Смысл и правила изменения - в
 * calib_store.h, там же описано, что делать при добавлении параметров.
 *
 * Здесь только реализация. Вся работа с флешем (страницы, стирание,
 * последовательность FSM, выравнивание ECC) сделана кодом TI в
 * my_Files/flash_eeprom/ - он взят из C2000Ware как есть, с двумя отмеченными
 * отличиями. Мы им только пользуемся.
 */

#include <stdint.h>
#include <stddef.h> // offsetof - граница контрольной суммы, см. calib_sum()

#include "myADC.h"
#include "calib_store.h"
#include "flash_eeprom/EEPROM_Config.h"

//---------------------------------------------------------------------------
// ПРОВЕРКА НА ЭТАПЕ СБОРКИ: влезает ли выбранное число сохранений в банк.
//
// Если при добавлении параметров данные разрастутся, компилятор остановится
// ИМЕННО ЗДЕСЬ с ошибкой вида "invalid type" на CALIB_FITS_IN_BANK. Это не
// поломка - это предупреждение, что надо уменьшить NUM_EEPROM_PAGES (или
// NUM_EEPROM_BANKS) в flash_eeprom/EEPROM_Config.h.
//
// Приём стандартный: если условие ложно, объявляется массив отрицательной
// длины, и трансляция останавливается. Ни кода, ни памяти это не занимает.
//---------------------------------------------------------------------------
#define CALIB_BANK_WORDS_USED                                                  \
    ((8U + (EEPROM_PAGE_DATA_SIZE + 8U) * NUM_EEPROM_PAGES) * NUM_EEPROM_BANKS)

#define CALIB_BANK_WORDS_AVAILABLE (32U * FLASH_SECTOR_SIZE) // BANK4: 32 сектора

typedef char CALIB_FITS_IN_BANK[(CALIB_BANK_WORDS_USED <= CALIB_BANK_WORDS_AVAILABLE) ? 1 : -1];

//---------------------------------------------------------------------------
// "В банке лежит не наш формат" - взводится в calib_load(), когда запись есть,
// но разобрать её не удалось.
//
// Такое бывает после изменения состава CalibBlob: при добавлении канала uSec
// страница выросла с 24 слов до 28, и разметка банка поехала. Старые записи
// при новой разметке попадают куда угодно, и место, которое код считает
// чистым, на деле уже запрограммировано. Запись в непустую ячейку флеш не
// принимает - FSM возвращает ошибку.
//
// Поэтому перед первой записью такой банк надо стереть. Данные в нём всё равно
// потеряны: разобрать чужой формат нельзя.
//---------------------------------------------------------------------------
static uint16_t calibBankSuspect = 0;

//---------------------------------------------------------------------------
// Сумма всех слов записи, кроме самого поля sum.
//
// Считается по словам, а не по полям: так добавление поля в ADCpar не требует
// править эту функцию. Сумма ловит стёртую страницу (все 0xFFFF) и грубое
// повреждение; от перестановки полей она не спасает - для этого CALIB_VERSION.
//
// ГРАНИЦА - offsetof, А НЕ "sizeof минус одно слово", и это исправлено
// 25.09.2026 после того, как ошибка была поймана на цели.
//
// Пока запись состояла из одних uint16_t, разницы не было: поле sum лежало
// последним, и sizeof - 1 точно на него и указывало. С появлением паспорта
// силовой части внутри оказались float, у CalibBlob стало выравнивание в два
// слова, и sizeof вырос на слово ПОСЛЕ sum. Сумма начала захватывать саму
// себя, а значит не сходилась НИКОГДА: calib_load() возвращал CALIB_BAD на
// собственную только что сделанную запись, и прибор молча уходил на заводские
// значения. Диагноз ставится легко - magic и version в записи верные, а сумма
// нет.
//
// Ровно та же ловушка в power_sum() (power_par.h), и там про неё написано
// отдельно: если однажды добавите float в ADCpar, здесь всё уже правильно.
//---------------------------------------------------------------------------
static uint16_t calib_sum(const CalibBlob *b)
{
    const uint16_t *w = (const uint16_t *)b;
    uint16_t        n = (uint16_t)offsetof(CalibBlob, sum); // слов до поля sum
    uint16_t        s = 0;
    uint16_t        i;

    for (i = 0; i < n; i++)
    {
        s = (uint16_t)(s + w[i]);
    }

    return s;
}

//---------------------------------------------------------------------------
// Чтение. Флеш здесь - обычная память: EEPROM_GetValidBank(1) только ходит по
// указателям и сравнивает слова состояния, ни одной команды Flash API. Отсюда
// и безопасность: вызывать можно когда угодно, инициализация FAPI не нужна.
//
// Признак "данных нет" берём не из флага Empty_EEPROM в коде TI (он живёт в
// ОЗУ и после включения питания всегда равен 1, даже когда во флеше лежит
// валидная запись), а из самого содержимого - по сигнатуре и сумме.
//---------------------------------------------------------------------------
uint16_t calib_load(void)
{
    CalibBlob       blob;
    uint16_t       *dst = (uint16_t *)&blob;
    const uint16_t *src;
    uint16_t        i;

    // Найти текущий банк и текущую страницу
    EEPROM_GetValidBank(1);

    // Первые 8 слов страницы - её состояние, данные идут следом
    src = (const uint16_t *)(Page_Pointer + 8);

    for (i = 0; i < sizeof(CalibBlob); i++)
    {
        dst[i] = src[i];
    }

    // Стёртый флеш читается как 0xFFFF во всех словах - это и есть "пусто"
    if (blob.magic == 0xFFFFU)
    {
        return CALIB_EMPTY;
    }

    if (blob.magic != CALIB_MAGIC)
    {
        calibBankSuspect = 1;
        return CALIB_BAD;
    }

    if (blob.version != CALIB_VERSION)
    {
        calibBankSuspect = 1;
        return CALIB_BAD;
    }

    if (blob.sum != calib_sum(&blob))
    {
        calibBankSuspect = 1;
        return CALIB_BAD;
    }

    // Всё сошлось - только теперь трогаем рабочие структуры.
    //
    // Раздавать паспорт по потребителям ЗДЕСЬ НЕЛЬЗЯ: calib_load() зовётся в
    // начале инициализации, а grid_tie_init() и plant_sim_init() идут позже и
    // затёрли бы розданное. Поэтому мы только кладём числа в pwr и reg, а
    // power_par_apply() зовёт main() после обеих init-функций.
    offsets = blob.offsets;
    kadc    = blob.kadc;
    pwr     = blob.pwr;
    reg     = blob.reg;

    return CALIB_OK;
}

//---------------------------------------------------------------------------
// Инициализация Flash API. Нужна только для записи.
//
// Частота 150 МГц - это SYSCLK данного процессора. В коде загрузчика,
// доставшемся от F280039C, здесь стоит 120: то значение относилось к прежнему
// кристаллу и на F28P55x неверно.
//---------------------------------------------------------------------------
uint16_t calib_store_init(void)
{
    Fapi_StatusType status;

    Flash_initModule(FLASH0CTRL_BASE, FLASH0ECC_BASE, 3);

    status = Fapi_initializeAPI(FlashTech_CPU0_BASE_ADDRESS, 150U);
    if (status != Fapi_Status_Success)
    {
        return (uint16_t)status;
    }

    status = Fapi_setActiveFlashBank(Fapi_FlashBank0);
    if (status != Fapi_Status_Success)
    {
        return (uint16_t)status;
    }

    // Считает маски защиты секторов и проверяет конфигурацию из
    // EEPROM_Config.h. Возвращает 0 при полном порядке; ненулевые значения -
    // предупреждения и ошибки, расшифровка в шапке EEPROM_Config_Check().
    // Банк НЕ стирает: этот вызов из оригинала TI убран, см. комментарий там.
    return (uint16_t)EEPROM_Config_Check();
}

//---------------------------------------------------------------------------
// Запись. Пишет во флеш, требует calib_store_init(). Только из фона.
//---------------------------------------------------------------------------
uint16_t calib_save(void)
{
    // Буфер размером в страницу, а не в CalibBlob: код TI пишет
    // EEPROM_PAGE_DATA_SIZE слов, то есть с округлением вверх до границы ECC.
    // Хвост за пределами CalibBlob заполняем 0xFFFF - значением стёртого
    // флеша, чтобы он не мешал при разборе.
    uint16_t  page[EEPROM_PAGE_DATA_SIZE];
    CalibBlob blob;
    uint16_t *src = (uint16_t *)&blob;
    uint16_t  i;

    //-----------------------------------------------------------------------
    // Некалиброванное во флеш НЕ ПИШЕМ.
    //
    // Пустая контрольная сумма - это признак "каналы после заводских значений
    // не калибровались", на нём построен разбор в checkEE(): crc == 0 даёт
    // Kadc_NOCAL / Offsets_NOCAL, а несовпадение суммы - другую ошибку. Это
    // разные вещи, и различать их нужно.
    //
    // Сумму ставит только тот, кто действительно калибрует: команды CAN
    // 198..203 для масштабов и SaveAdcOffsets() для нулей. Значит обе суммы в
    // нуле означают, что сохранять пока нечего.
    //
    // Достаточно, чтобы заданной была ОДНА из четырёх: нули, масштабы, паспорт
    // силовой части и коэффициенты регуляторов настраиваются независимо, и
    // сохранить надо уже после первой из них. Остальные уйдут в запись с
    // нулевой суммой и при чтении честно опознаются как незаданные.
    //
    // С 25.09.2026 половин четыре, а не две: к калибровке измерительного
    // тракта добавилась настройка самого прибора (power_par.h).
    //-----------------------------------------------------------------------
    if ((offsets.crc == 0U) && (kadc.crc == 0U) &&
        (pwr.crc == 0U) && (reg.crc == 0U))
    {
        return CALIB_NOTCAL;
    }

    blob.magic   = CALIB_MAGIC;
    blob.version = CALIB_VERSION;
    blob.offsets = offsets;
    blob.kadc    = kadc;
    blob.pwr     = pwr;
    blob.reg     = reg;
    blob.sum     = calib_sum(&blob);

    for (i = 0; i < EEPROM_PAGE_DATA_SIZE; i++)
    {
        page[i] = (i < sizeof(CalibBlob)) ? src[i] : 0xFFFFU;
    }

    EEPROM_Write(page);

    return CALIB_OK;
}

//---------------------------------------------------------------------------
// dbg Фоновая часть: сохранение по команде из отладчика.
//
// Flash API инициализируется здесь, при первом сохранении, а не при старте
// прибора. Так до первой команды оператора код вообще не касается флеша:
// пока никто не написал calibCmd = 1, эта функция не делает ничего.
//---------------------------------------------------------------------------
volatile uint16_t calibCmd        = 0;
volatile uint16_t calibSaveReq    = 0;
uint16_t          calibSaveStatus = 0;

static uint16_t calibInitDone = 0;

//---------------------------------------------------------------------------
// Собственно сохранение с ленивой инициализацией Flash API.
//---------------------------------------------------------------------------
static void calib_do_save(void)
{
    if (!calibInitDone)
    {
        uint16_t cfg = calib_store_init();

        // EEPROM_Config_Check() возвращает две разные вещи. Фатальные ошибки
        // конфигурации - 0xFFFF (банк не годится), 0xEEEE (неверные номера
        // секторов), 0xCCCC (данные не влезают). Мелкие значения (1, 2, 4 и их
        // суммы) - это предупреждения TI, записи они не мешают.
        // Останавливаемся только на фатальных.
        if ((cfg == 0xFFFFU) || (cfg == 0xEEEEU) || (cfg == 0xCCCCU))
        {
            calibSaveStatus = cfg;
            return;
        }

        calibInitDone = 1;
    }

    // В банке чужой формат - стереть, иначе запись попадёт в непустую ячейку
    // и Flash API вернёт ошибку. Подробности у объявления calibBankSuspect.
    if (calibBankSuspect)
    {
        calibBankSuspect = 0;
        EEPROM_Erase();
    }

    {
        uint16_t faultsBefore = eepromFaultCnt;

        calibSaveStatus = calib_save();

        // Flash API об ошибках не сообщает возвратом - он звал Sample_Error(),
        // а та теперь просто считает. Сравниваем счётчик до и после.
        if (eepromFaultCnt != faultsBefore)
        {
            calibSaveStatus = CALIB_FLASH_ERR;
        }
    }
}

//---------------------------------------------------------------------------
// Привести хранилище в соответствие после сброса одной из половин калибровки.
//
// Нули и масштабы сбрасываются по отдельности (команды CAN 206 и 213), а во
// флеше они лежат ОДНОЙ записью. Поэтому решение зависит от того, что осталось:
//
//   осталась хоть одна калиброванная половина - сохранить новую запись. В ней
//   сброшенная половина уйдёт с нулевой суммой и при чтении честно опознается
//   как некалиброванная, а вторая сохранится;
//
//   обе половины сброшены - сохранять нечего, и просто не писать нельзя: во
//   флеше осталась бы прежняя запись, и после перезапуска сброс "откатился"
//   бы. Поэтому банк стирается.
//---------------------------------------------------------------------------
void calib_store_after_reset(void)
{
    if ((offsets.crc == 0U) && (kadc.crc == 0U) &&
        (pwr.crc == 0U) && (reg.crc == 0U))
    {
        calibCmd = 2; // фону: стереть банк
    }
    else
    {
        calibSaveReq = 1; // фону: сохранить то, что осталось
    }
}

void calib_store_background(void)
{
    // Заявку ставят обработчики команд CAN 198..203 и SaveAdcOffsets() - то
    // есть только те места, где калибровка действительно изменилась. Снимаем
    // её здесь, ДО сохранения: если во время записи придёт ещё одна команда,
    // её заявка не потеряется и отработает следующим проходом.
    if (calibSaveReq)
    {
        calibSaveReq = 0;
        calib_do_save();
    }

    // dbg Ручные команды из отладчика.
    if (calibCmd == 1)
    {
        calib_do_save();
        calibCmd = 0;
    }
    else if (calibCmd == 2)
    {
        // Стереть банк - вернуть прибор в состояние "не калиброван".
        //
        // Нужно, в частности, если во флеш попали заводские значения с
        // посчитанной суммой: отличить их от настоящей калибровки после записи
        // уже нельзя, и единственный честный выход - стереть.
        if (calibInitDone || (calib_store_init() < 0xCCCCU))
        {
            calibInitDone = 1;
            EEPROM_Erase();
            calibSaveStatus = CALIB_EMPTY;
        }

        calibCmd = 0;
    }
    else if (calibCmd != 0)
    {
        calibCmd = 0; // неизвестная команда - просто сбрасываем
    }
}
